## drivers/char/Kconfig
```kconfig
# SPDX-License-Identifier: (GPL-2.0+ OR MIT)

menu "Character devices"

source "$(COMMON_DRIVERS_DIR)/drivers/char/hw_random/Kconfig"

config AMLOGIC_GPIOMEM
	tristate "/dev/gpiomem rootless GPIO access via mmap() on the Amlogic"
	default m
	help
	  Provides users with root-free access to the GPIO registers
	  on Meson s7d platform. Calling mmap(/dev/gpiomem) will map the GPIO
	  register page to the user's pointer. This drvier can allow to access
	  gpio memory area in user account.

endmenu
```
