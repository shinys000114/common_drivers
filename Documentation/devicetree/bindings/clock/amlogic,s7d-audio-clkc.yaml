## Documentation/devicetree/bindings/display/bridge/amlogic,s7d-hdmi-native.yaml
```yaml
# SPDX-License-Identifier: (GPL-2.0-only OR BSD-2-Clause)
# Copyright (c) 2026 Hardkernel Co., Ltd.
%YAML 1.2
---
$id: http://devicetree.org/schemas/display/bridge/amlogic,s7d-hdmi-native.yaml#
$schema: http://devicetree.org/meta-schemas/core.yaml#

title: Amlogic S7D HDMI transmitter

maintainers:
  - YoungSoo Shin <shinys000114@gmail.com>

description: |
  The transmitter contains the HDMI TOP and core register banks, DDC controller,
  HPD detection, packet generator, and I2S audio insertion. Register accesses use
  the firmware SMC interface; the banks are reserved but not directly mapped.
  The analogue transmitter is a separate PHY and the pixel clocks are supplied
  by the clock controller. The input is connected to the S7D VPU ENCP output.
  The driver supplies the HDMI connector and a zero-cell playback codec DAI.

allOf:
  - $ref: /schemas/sound/dai-common.yaml#

properties:
  compatible:
    const: amlogic,s7d-hdmi-native

  reg:
    items:
      - description: 64 KiB HDMI TOP register window.
      - description: 64 KiB HDMI core register window.

  reg-names:
    items:
      - const: top
      - const: core

  interrupts:
    maxItems: 1
    description: HDMI TOP interrupt, level high.

  clocks:
    items:
      - description: Peripheral bus gate.
      - description: Transmitter system clock.
      - description: Transmitter peripheral interface clock.
      - description: Transmitter 200 MHz reference clock.
      - description: Pixel clock.
      - description: Front-end clock.
      - description: Audio packet clock.
      - description: Pixel clock mux.
      - description: Front-end clock mux.
      - description: Common video divider selected by both video muxes.

  clock-names:
    items:
      - const: apb
      - const: sys
      - const: prif
      - const: 200m
      - const: pixel
      - const: fe
      - const: aud
      - const: pixel-mux
      - const: fe-mux
      - const: video-parent

  resets:
    maxItems: 2

  reset-names:
    items:
      - const: tx
      - const: apb

  power-domains:
    maxItems: 1
    description: Shared VPU and HDMI firmware power domain.

  phys:
    maxItems: 1

  phy-names:
    const: hdmi

  '#sound-dai-cells':
    const: 0

  port:
    $ref: /schemas/graph.yaml#/properties/port
    description: Input from the S7D VPU ENCP encoder.
    properties:
      endpoint:
        $ref: /schemas/graph.yaml#/properties/endpoint
        required:
          - remote-endpoint
    required:
      - endpoint

required:
  - compatible
  - reg
  - reg-names
  - interrupts
  - clocks
  - clock-names
  - resets
  - reset-names
  - power-domains
  - phys
  - phy-names
  - '#sound-dai-cells'
  - port

unevaluatedProperties: false

examples:
  - |
    #include <dt-bindings/clock/amlogic,s7d-clkc.h>
    #include <dt-bindings/interrupt-controller/arm-gic.h>
    #include <dt-bindings/power/s7d-pd.h>
    #include <dt-bindings/reset/amlogic,meson-s7d-reset.h>

    hdmi@fe300000 {
        compatible = "amlogic,s7d-hdmi-native";
        #sound-dai-cells = <0>;
        reg = <0xfe300000 0x10000>, <0xfe310000 0x10000>;
        reg-names = "top", "core";
        interrupts = <GIC_SPI 204 IRQ_TYPE_LEVEL_HIGH>;
        pinctrl-names = "default";
        pinctrl-0 = <&hdmitx_hpd &hdmitx_ddc>;
        clocks = <&clkc CLKID_SYS_HDMITX_APB>, <&clkc CLKID_HDMITX_SYS>,
                 <&clkc CLKID_HDMITX_PRIF>, <&clkc CLKID_HDMITX_200M>,
                 <&clkc CLKID_HDMITX_PIXEL>, <&clkc CLKID_HDMITX_FE>,
                 <&clkc CLKID_HDMITX_AUD>, <&clkc CLKID_HDMITX_PIXEL_MUX>,
                 <&clkc CLKID_HDMITX_FE_MUX>, <&clkc CLKID_VIDEO0_DIV1>;
        clock-names = "apb", "sys", "prif", "200m", "pixel", "fe", "aud",
                      "pixel-mux", "fe-mux", "video-parent";
        assigned-clocks = <&clkc CLKID_HDMITX_AUD_MUX>;
        assigned-clock-parents = <&clkc CLKID_FCLK_DIV5>;
        resets = <&reset RESET_HDMI_TX>, <&reset RESET_HDMITX_CAPB3>;
        reset-names = "tx", "apb";
        power-domains = <&pwrdm PDID_S7D_VPU_HDMI>;
        phys = <&hdmi_phy>;
        phy-names = "hdmi";

        port {
            hdmi_in: endpoint {
                remote-endpoint = <&vpu_out>;
            };
        };
    };
```

## Documentation/devicetree/bindings/display/bridge/amlogic,s7d-hdmi-tx.yaml
```yaml
# SPDX-License-Identifier: (GPL-2.0-only OR BSD-2-Clause)
# Copyright (c) 2026 Hardkernel Co., Ltd.
%YAML 1.2
---
$id: http://devicetree.org/schemas/display/bridge/amlogic,s7d-hdmi-tx.yaml#
$schema: http://devicetree.org/meta-schemas/core.yaml#

title: Amlogic S7D HDMI transmitter

maintainers:
  - YoungSoo Shin <shinys000114@gmail.com>

description: |
  The transmitter contains the HDMI TOP and core register banks, DDC controller,
  HPD detection, packet generator, and I2S audio insertion. Register accesses use
  the firmware SMC interface; the banks are reserved but not directly mapped.
  The analogue transmitter is a separate PHY and the pixel clocks are supplied
  by the clock controller. The input is connected to the S7D VPU ENCP output.
  The driver supplies the HDMI connector and a zero-cell playback codec DAI.

allOf:
  - $ref: /schemas/sound/dai-common.yaml#

properties:
  compatible:
    const: amlogic,s7d-hdmi-tx

  reg:
    items:
      - description: 64 KiB HDMI TOP register window.
      - description: 64 KiB HDMI core register window.

  reg-names:
    items:
      - const: top
      - const: core

  interrupts:
    maxItems: 1
    description: HDMI TOP interrupt, level high.

  clocks:
    items:
      - description: Peripheral bus gate.
      - description: Transmitter system clock.
      - description: Transmitter peripheral interface clock.
      - description: Transmitter 200 MHz reference clock.
      - description: Pixel clock.
      - description: Front-end clock.
      - description: Audio packet clock.
      - description: Pixel clock mux.
      - description: Front-end clock mux.
      - description: Common video divider selected by both video muxes.
      - description: Half-rate video divider for the 4:2:0 pixel clock.

  clock-names:
    items:
      - const: apb
      - const: sys
      - const: prif
      - const: 200m
      - const: pixel
      - const: fe
      - const: aud
      - const: pixel-mux
      - const: fe-mux
      - const: video-parent
      - const: video-div2

  resets:
    maxItems: 2

  reset-names:
    items:
      - const: tx
      - const: apb

  power-domains:
    maxItems: 1
    description: Shared VPU and HDMI firmware power domain.

  phys:
    maxItems: 1

  phy-names:
    const: hdmi

  amlogic,spd-vendor:
    $ref: /schemas/types.yaml#/definitions/string
    default: Amlogic
    description:
      Vendor name sent in the Source Product Description InfoFrame, at most 8
      characters.

  amlogic,spd-product:
    $ref: /schemas/types.yaml#/definitions/string
    default: S7D
    description:
      Product description sent in the SPD InfoFrame, at most 16 characters.

  amlogic,spd-source-type:
    $ref: /schemas/types.yaml#/definitions/string
    enum: [unknown, stb, dvd, d-vhs, hdd, dvc, dsc, vcd, game, pc, bd, sacd,
           hd-dvd, pmp]
    default: pc
    description:
      CTA-861 source device information sent in the SPD InfoFrame. Sinks may
      use it to label the input or to choose their picture processing.

  '#sound-dai-cells':
    const: 1
    description: Audio input, 0 for I2S and 1 for SPDIF.

  port:
    $ref: /schemas/graph.yaml#/properties/port
    description: Input from the S7D VPU ENCP encoder.
    properties:
      endpoint:
        $ref: /schemas/graph.yaml#/properties/endpoint
        required:
          - remote-endpoint
    required:
      - endpoint

required:
  - compatible
  - reg
  - reg-names
  - interrupts
  - clocks
  - clock-names
  - resets
  - reset-names
  - power-domains
  - phys
  - phy-names
  - '#sound-dai-cells'
  - port

unevaluatedProperties: false

examples:
  - |
    #include <dt-bindings/clock/amlogic,s7d-clkc.h>
    #include <dt-bindings/interrupt-controller/arm-gic.h>
    #include <dt-bindings/power/s7d-pd.h>
    #include <dt-bindings/reset/amlogic,meson-s7d-reset.h>

    hdmi@fe300000 {
        compatible = "amlogic,s7d-hdmi-tx";
        #sound-dai-cells = <1>;
        reg = <0xfe300000 0x10000>, <0xfe310000 0x10000>;
        reg-names = "top", "core";
        interrupts = <GIC_SPI 204 IRQ_TYPE_LEVEL_HIGH>;
        pinctrl-names = "default";
        pinctrl-0 = <&hdmitx_hpd &hdmitx_ddc>;
        clocks = <&clkc CLKID_SYS_HDMITX_APB>, <&clkc CLKID_HDMITX_SYS>,
                 <&clkc CLKID_HDMITX_PRIF>, <&clkc CLKID_HDMITX_200M>,
                 <&clkc CLKID_HDMITX_PIXEL>, <&clkc CLKID_HDMITX_FE>,
                 <&clkc CLKID_HDMITX_AUD>, <&clkc CLKID_HDMITX_PIXEL_MUX>,
                 <&clkc CLKID_HDMITX_FE_MUX>, <&clkc CLKID_VIDEO0_DIV1>,
                 <&clkc CLKID_VIDEO0_DIV2>;
        clock-names = "apb", "sys", "prif", "200m", "pixel", "fe", "aud",
                      "pixel-mux", "fe-mux", "video-parent", "video-div2";
        assigned-clocks = <&clkc CLKID_HDMITX_AUD_MUX>;
        assigned-clock-parents = <&clkc CLKID_FCLK_DIV5>;
        resets = <&reset RESET_HDMI_TX>, <&reset RESET_HDMITX_CAPB3>;
        reset-names = "tx", "apb";
        power-domains = <&pwrdm PDID_S7D_VPU_HDMI>;
        phys = <&hdmi_phy>;
        phy-names = "hdmi";

        port {
            hdmi_in: endpoint {
                remote-endpoint = <&vpu_out>;
            };
        };
    };
```

## Documentation/devicetree/bindings/dma-buf/hardkernel,odroidc5-scanout-heap.yaml
```yaml
# SPDX-License-Identifier: GPL-2.0-only OR BSD-2-Clause
# Copyright (c) 2026 Hardkernel Co., Ltd.
%YAML 1.2
---
$id: http://devicetree.org/schemas/dma-buf/hardkernel,odroidc5-scanout-heap.yaml#
$schema: http://devicetree.org/meta-schemas/core.yaml#

title: Hardkernel ODROID-C5 contiguous graphics DMA heap

maintainers:
  - YoungSoo Shin <shinys000114@gmail.com>

description: |
  This board device exports one dedicated reusable CMA pool for contiguous
  graphics DMA-BUF allocations. It is separate from the shared-dma-pool node
  below /reserved-memory and must reference that pool with memory-region.
  The referenced pool must have compatible shared-dma-pool and reusable;
  it must not have no-map. No MMIO resource or interrupt is associated with
  the heap device.

properties:
  compatible:
    const: hardkernel,odroidc5-scanout-heap

  memory-region:
    maxItems: 1
    description: Dedicated reusable shared-dma-pool for graphics buffers.

required:
  - compatible
  - memory-region

additionalProperties: false

examples:
  - |
    graphics-heap {
        compatible = "hardkernel,odroidc5-scanout-heap";
        memory-region = <&graphics_pool>;
    };
```

## Documentation/devicetree/bindings/firmware/amlogic,s7d-video-firmware.yaml
```yaml
# SPDX-License-Identifier: GPL-2.0-only OR BSD-2-Clause
# Copyright (c) 2026 Hardkernel Co., Ltd.
%YAML 1.2
---
$id: http://devicetree.org/schemas/firmware/amlogic,s7d-video-firmware.yaml#
$schema: http://devicetree.org/meta-schemas/core.yaml#

title: Amlogic S7D resident video firmware service

maintainers:
  - YoungSoo Shin <shinys000114@gmail.com>

description: |
  A singleton service below /firmware owns the video firmware archive shared
  by the codec engines. It transfers the archive through OP-TEE using SMC.
  Codec consumers reference this node with amlogic,video-firmware and must
  reference the same OP-TEE device with amlogic,tee. The service has no MMIO
  aperture, interrupt, clock or reserved-memory region of its own.

properties:
  compatible:
    const: amlogic,s7d-video-firmware

  amlogic,tee:
    $ref: /schemas/types.yaml#/definitions/phandle
    description: Phandle to an enabled linaro,optee-tz device using SMC.

required:
  - compatible
  - amlogic,tee

additionalProperties: false

examples:
  - |
    firmware {
        video-firmware {
            compatible = "amlogic,s7d-video-firmware";
            amlogic,tee = <&optee>;
        };
    };
```

## Documentation/devicetree/bindings/gpu/amlogic,s7d-mali.yaml
```yaml
# SPDX-License-Identifier: GPL-2.0-only OR BSD-2-Clause
# Copyright (c) 2026 Hardkernel Co., Ltd.
%YAML 1.2
---
$id: http://devicetree.org/schemas/gpu/amlogic,s7d-mali.yaml#
$schema: http://devicetree.org/meta-schemas/core.yaml#

title: Amlogic S7D Mali Valhall GPU with a fixed supply

maintainers:
  - YoungSoo Shin <shinys000114@gmail.com>

description: |
  The S7D Mali-G310 GPU has separate core and stack clocks and two reset
  inputs. The ODROID-C5 integration uses a fixed supply and clock gating for
  runtime power management. It has no controllable regulator or GPU power
  domain.

  The S7D Panthor driver uses this node by default; the resource-based vendor
  kbase CSF integration is the alternative, and only one of them is built.
  Panthor backs shareable buffers with the optional scanout memory region, so
  that the display controller, which needs contiguous buffers, can scan them
  out. kbase does not use the region.

properties:
  $nodename:
    pattern: '^gpu@[a-f0-9]+$'

  compatible:
    items:
      - const: amlogic,s7d-mali
      - const: arm,mali-valhall-csf

  reg:
    maxItems: 1
    description: GPU register aperture, 8 MiB.

  interrupts:
    items:
      - description: GPU interrupt
      - description: MMU interrupt
      - description: Job interrupt

  interrupt-names:
    items:
      - const: gpu
      - const: mmu
      - const: job

  clocks:
    items:
      - description: GPU core clock
      - description: GPU stack clock

  clock-names:
    items:
      - const: core
      - const: stacks

  resets:
    items:
      - description: GPU bus reset
      - description: GPU core reset

  reset-names:
    items:
      - const: bus
      - const: core

  operating-points-v2: true

  memory-region:
    maxItems: 1
    description:
      Reusable shared-dma-pool that backs shareable buffers for scanout.

  memory-region-names:
    items:
      - const: scanout

  '#cooling-cells':
    const: 2

  firmware-name:
    maxItems: 1
    description: CSF firmware filename; defaults to mali_csffw.bin.

required:
  - compatible
  - reg
  - interrupts
  - interrupt-names
  - clocks
  - clock-names
  - resets
  - reset-names
  - operating-points-v2

additionalProperties: false

examples:
  - |
    #include <dt-bindings/interrupt-controller/arm-gic.h>
    #include <dt-bindings/interrupt-controller/irq.h>

    gpu@fd000000 {
        compatible = "amlogic,s7d-mali", "arm,mali-valhall-csf";
        reg = <0xfd000000 0x800000>;
        interrupts = <GIC_SPI 144 IRQ_TYPE_LEVEL_HIGH>,
                     <GIC_SPI 145 IRQ_TYPE_LEVEL_HIGH>,
                     <GIC_SPI 146 IRQ_TYPE_LEVEL_HIGH>;
        interrupt-names = "gpu", "mmu", "job";
        clocks = <&gpu_core_clk>, <&gpu_stack_clk>;
        clock-names = "core", "stacks";
        resets = <&gpu_bus_reset>, <&gpu_core_reset>;
        reset-names = "bus", "core";
        operating-points-v2 = <&gpu_opp_table>;
        memory-region = <&graphics_pool>;
        memory-region-names = "scanout";
        #cooling-cells = <2>;
    };
```
