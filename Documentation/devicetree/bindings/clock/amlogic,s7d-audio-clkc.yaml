## Documentation/devicetree/bindings/sound/amlogic,s7d-sound-card.yaml
```yaml
# SPDX-License-Identifier: (GPL-2.0-only OR BSD-2-Clause)
%YAML 1.2
---
$id: http://devicetree.org/schemas/sound/amlogic,s7d-sound-card.yaml#
$schema: http://devicetree.org/meta-schemas/core.yaml#

title: Amlogic S7D sound card

maintainers:
  - YoungSoo Shin <shinys000114@gmail.com>

description:
  The AXG sound card with initial mixer values from the device tree.

allOf:
  - $ref: sound-card-common.yaml#

properties:
  compatible:
    const: amlogic,s7d-sound-card

  amlogic,mixer-defaults:
    $ref: /schemas/types.yaml#/definitions/non-unique-string-array
    description:
      Control name and value pairs applied once when the card registers,
      so the outputs work without a UCM profile. A value is an enumerated
      item name, "on" or "off", or one integer per channel separated by
      commas, the last one repeating.

  audio-aux-devs:
    $ref: /schemas/types.yaml#/definitions/phandle-array
    description: list of auxiliary devices

  audio-widgets:
    $ref: /schemas/types.yaml#/definitions/non-unique-string-array
    description:
      A list off component DAPM widget. Each entry is a pair of strings,
      the first being the widget type, the second being the widget name

  clocks:
    minItems: 1
    maxItems: 3
    description:
      Base PLL clocks of audio susbsytem, used to configure base clock
      frequencies for different audio use-cases.

patternProperties:
  "^dai-link-[0-9]+$":
    type: object
    additionalProperties: false
    description:
      Container for dai-link level properties and the CODEC sub-nodes.
      There should be at least one (and probably more) subnode of this type

    properties:
      dai-format:
        $ref: /schemas/types.yaml#/definitions/string
        enum: [ i2s, left-j, dsp_a ]

      dai-tdm-slot-num:
        $ref: /schemas/types.yaml#/definitions/uint32
        description:
          Number of slots in use. If omitted, slot number is set to
          accommodate the largest mask provided.
        maximum: 32

      dai-tdm-slot-width:
        $ref: /schemas/types.yaml#/definitions/uint32
        description: Width in bits for each slot
        enum: [ 8, 16, 20, 24, 32 ]
        default: 32

      mclk-fs:
        $ref: /schemas/types.yaml#/definitions/uint32
        description:
          Multiplication factor between the frame rate and master clock
          rate

      sound-dai:
        maxItems: 1
        description: phandle of the CPU DAI

    patternProperties:
      "^dai-tdm-slot-(t|r)x-mask-[0-3]$":
        $ref: /schemas/types.yaml#/definitions/uint32-array
        minItems: 1
        maxItems: 32
        description:
          Transmit and receive cpu slot masks of each TDM lane
          When omitted, mask is assumed to have to no slots. A valid
          interface must have at least one slot, so at least one these
          mask should be provided with an enabled slot.

      "^codec(-[0-9]+)?$":
        type: object
        additionalProperties: false
        description:
          dai-link representing backend links should have at least one subnode.
          One subnode for each codec of the dai-link. dai-link representing
          frontend links have no codec, therefore have no subnodes

        properties:
          sound-dai:
            maxItems: 1
            description: phandle of the codec DAI

        patternProperties:
          "^dai-tdm-slot-(t|r)x-mask$":
            $ref: /schemas/types.yaml#/definitions/uint32-array
            minItems: 1
            maxItems: 32
            description: Transmit and receive codec slot masks

        required:
          - sound-dai

    required:
      - sound-dai

required:
  - dai-link-0

unevaluatedProperties: false

examples:
  - |
    sound {
        compatible = "amlogic,s7d-sound-card";
        model = "AML-AUGESOUND";
        audio-routing = "TDMOUT_B IN 0", "FRDDR_A OUT 1",
                        "TDM_B Playback", "TDMOUT_B OUT";
        amlogic,mixer-defaults = "FRDDR_A SINK 1 SEL", "OUT 1",
                                 "FRDDR_A SRC 1 EN Switch", "on",
                                 "TDMOUT_B SRC SEL", "IN 0";

        dai-link-0 {
            sound-dai = <&frddr_a>;
        };

        dai-link-1 {
            sound-dai = <&tdmif_b>;
            dai-format = "i2s";
            dai-tdm-slot-tx-mask-0 = <1 1>;
            mclk-fs = <256>;

            codec {
                sound-dai = <&tohdmitx 1>;
            };
        };
    };
```

## Documentation/devicetree/bindings/sound/amlogic,s7d-spdifout.yaml
```yaml
# SPDX-License-Identifier: (GPL-2.0-only OR BSD-2-Clause)
%YAML 1.2
---
$id: http://devicetree.org/schemas/sound/amlogic,s7d-spdifout.yaml#
$schema: http://devicetree.org/meta-schemas/core.yaml#

title: Amlogic S7D SPDIF output

maintainers:
  - YoungSoo Shin <shinys000114@gmail.com>

description:
  SPDIF A and B outputs of the S7D audio block. The channel mask is
  CTRL0[15:0] and the source can be any of the four FRDDRs.

properties:
  compatible:
    const: amlogic,s7d-spdifout

  reg:
    maxItems: 1

  "#sound-dai-cells":
    const: 0

  clocks:
    items:
      - description: Peripheral clock
      - description: SPDIF output master clock

  clock-names:
    items:
      - const: pclk
      - const: mclk

  resets:
    maxItems: 1

required:
  - compatible
  - reg
  - "#sound-dai-cells"
  - clocks
  - clock-names
  - resets

allOf:
  - $ref: dai-common.yaml#

unevaluatedProperties: false

examples:
  - |
    #include <dt-bindings/clock/amlogic,s7d-audio-clkc.h>
    #include <dt-bindings/reset/amlogic,s7d-audio-reset.h>

    audio-controller@680 {
        compatible = "amlogic,s7d-spdifout";
        reg = <0x680 0x50>;
        #sound-dai-cells = <0>;
        clocks = <&clkc_audio CLKID_AUDIO_GATE_SPDIFOUT_B>,
                 <&clkc_audio CLKID_AUDIO_SPDIFOUT_B>;
        clock-names = "pclk", "mclk";
        resets = <&clkc_audio S7D_AUDIO_RESET_SPDIFOUTB>;
    };
```

## Documentation/devicetree/bindings/sound/amlogic,s7d-t9015.yaml
```yaml
# SPDX-License-Identifier: (GPL-2.0-only OR BSD-2-Clause)
# Copyright (c) 2026 Hardkernel Co., Ltd.
%YAML 1.2
---
$id: http://devicetree.org/schemas/sound/amlogic,s7d-t9015.yaml#
$schema: http://devicetree.org/meta-schemas/core.yaml#

title: Amlogic S7D T9015 stereo line-output DAC

maintainers:
  - YoungSoo Shin <shinys000114@gmail.com>

description: |
  The internal DAC receives I2S from TDMOUT C through the audio controller's
  TOACODEC route. It has its own register bank, peripheral clock and reset.
  Its playback DAI consumes the internally supplied serial clocks and has
  no microphone or capture interface.

allOf:
  - $ref: dai-common.yaml#

properties:
  compatible:
    const: amlogic,s7d-t9015

  '#sound-dai-cells':
    const: 0

  reg:
    maxItems: 1
    description: T9015 register bank.

  clocks:
    maxItems: 1
    description: Codec peripheral bus clock.

  clock-names:
    const: pclk

  resets:
    maxItems: 1
    description: Codec reset.

  reset-names:
    const: acodec

required:
  - compatible
  - '#sound-dai-cells'
  - reg
  - clocks
  - clock-names
  - resets
  - reset-names

unevaluatedProperties: false

examples:
  - |
    codec@fe01a000 {
        compatible = "amlogic,s7d-t9015";
        reg = <0xfe01a000 0x24>;
        #sound-dai-cells = <0>;
        clocks = <&clkc 0>;
        clock-names = "pclk";
        resets = <&reset 0>;
        reset-names = "acodec";
    };
```
