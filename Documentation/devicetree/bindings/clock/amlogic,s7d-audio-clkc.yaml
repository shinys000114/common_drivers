## Documentation/devicetree/bindings/reset/amlogic,s7d-reset.yaml
```yaml
# SPDX-License-Identifier: (GPL-2.0-only OR BSD-2-Clause)
# Copyright (c) 2026 Hardkernel Co., Ltd.
%YAML 1.2
---
$id: http://devicetree.org/schemas/reset/amlogic,s7d-reset.yaml#
$schema: http://devicetree.org/meta-schemas/core.yaml#

title: Amlogic S7D reset controller

maintainers:
  - YoungSoo Shin <shinys000114@gmail.com>

description: |
  Six banks of 32 reset lines have pulse, LEVEL and MASK registers. LEVEL
  is active low; a set MASK bit holds the corresponding reset deasserted.
  Reset specifiers use the IDs in dt-bindings/reset/amlogic,meson-s7d-reset.h.
  The register resource covers these three banks only. The watchdog,
  secure reset and write-protection registers are outside this resource.

properties:
  compatible:
    const: amlogic,s7d-reset

  reg:
    maxItems: 1
    description: Pulse, LEVEL and MASK registers, 0x98 bytes in total.

  '#reset-cells':
    const: 1

required:
  - compatible
  - reg
  - '#reset-cells'

additionalProperties: false

examples:
  - |
    reset-controller@fe002000 {
        compatible = "amlogic,s7d-reset";
        reg = <0xfe002000 0x98>;
        #reset-cells = <1>;
    };
```

## Documentation/devicetree/bindings/reset/amlogic,s7d-vpu-reset.yaml
```yaml
# SPDX-License-Identifier: (GPL-2.0-only OR BSD-2-Clause)
# Copyright (c) 2026 Hardkernel Co., Ltd.
%YAML 1.2
---
$id: http://devicetree.org/schemas/reset/amlogic,s7d-vpu-reset.yaml#
$schema: http://devicetree.org/meta-schemas/core.yaml#

title: Amlogic S7D VPU local AFBC reset controller

maintainers:
  - YoungSoo Shin <shinys000114@gmail.com>

description: |
  This reset controller is a child of amlogic,s7d-vpu and shares its
  VCBUS regmap. It owns bits 22 through 19 of VIU_SW_RESET at word offset
  0x1a01. It has no separate register, clock, or power-domain resources.
  The single reset argument selects a reset defined in
  dt-bindings/reset/amlogic,s7d-vpu-reset.h. The parent registers the provider
  before requesting the local resets and controls access to the register bank.

properties:
  compatible:
    const: amlogic,s7d-vpu-reset

  '#reset-cells':
    const: 1

required:
  - compatible
  - '#reset-cells'

additionalProperties: false

examples:
  - |
    display-controller@ff000000 {
        reg = <0xff000000 0x40000>;

        reset-controller {
            compatible = "amlogic,s7d-vpu-reset";
            #reset-cells = <1>;
        };
    };
```

## Documentation/devicetree/bindings/sound/amlogic,s7d-audio-fifo.yaml
```yaml
# SPDX-License-Identifier: (GPL-2.0-only OR BSD-2-Clause)
%YAML 1.2
---
$id: http://devicetree.org/schemas/sound/amlogic,s7d-audio-fifo.yaml#
$schema: http://devicetree.org/meta-schemas/core.yaml#

title: Amlogic S7D audio FIFO controllers

maintainers:
  - YoungSoo Shin <shinys000114@gmail.com>

description:
  FRDDR (playback) and TODDR (capture) DMA FIFOs of the S7D audio block.
  The register layout follows the SM1, with an 8-bit channel count in
  FRDDR CTRL2 and a 5-bit TODDR source select.

properties:
  compatible:
    enum:
      - amlogic,s7d-frddr
      - amlogic,s7d-toddr

  reg:
    maxItems: 1

  "#sound-dai-cells":
    const: 0

  clocks:
    items:
      - description: Peripheral clock

  interrupts:
    maxItems: 1

  resets:
    items:
      - description: Memory arbiter port
      - description: FIFO reset

  reset-names:
    items:
      - const: arb
      - const: rst

  amlogic,fifo-depth:
    $ref: /schemas/types.yaml#/definitions/uint32
    description: Size of the controller's fifo in bytes

required:
  - compatible
  - reg
  - "#sound-dai-cells"
  - clocks
  - interrupts
  - resets
  - reset-names
  - amlogic,fifo-depth

allOf:
  - $ref: dai-common.yaml#

unevaluatedProperties: false

examples:
  - |
    #include <dt-bindings/clock/amlogic,s7d-audio-clkc.h>
    #include <dt-bindings/interrupt-controller/arm-gic.h>
    #include <dt-bindings/reset/amlogic,meson-axg-audio-arb.h>
    #include <dt-bindings/reset/amlogic,s7d-audio-reset.h>

    audio-controller@1c0 {
        compatible = "amlogic,s7d-frddr";
        reg = <0x1c0 0x2c>;
        #sound-dai-cells = <0>;
        clocks = <&clkc_audio CLKID_AUDIO_GATE_FRDDRA>;
        interrupts = <GIC_SPI 36 IRQ_TYPE_EDGE_RISING>;
        resets = <&arb AXG_ARB_FRDDR_A>, <&clkc_audio S7D_AUDIO_RESET_FRDDRA>;
        reset-names = "arb", "rst";
        amlogic,fifo-depth = <1024>;
    };
```

## Documentation/devicetree/bindings/sound/amlogic,s7d-audio-glue.yaml
```yaml
# SPDX-License-Identifier: (GPL-2.0-only OR BSD-2-Clause)
%YAML 1.2
---
$id: http://devicetree.org/schemas/sound/amlogic,s7d-audio-glue.yaml#
$schema: http://devicetree.org/meta-schemas/core.yaml#

title: Amlogic S7D HDMI TX and internal DAC audio glue

maintainers:
  - YoungSoo Shin <shinys000114@gmail.com>

description:
  TOHDMITX selects the I2S and SPDIF inputs of the HDMI transmitter and
  generates its 128 fs MCLK; TOACODEC selects the TDM output and lanes of
  the internal DAC. Both have split clock and data enables on the S7D.

properties:
  $nodename:
    pattern: "^audio-controller@.*"

  compatible:
    enum:
      - amlogic,s7d-toacodec
      - amlogic,s7d-tohdmitx

  reg:
    maxItems: 1

  resets:
    maxItems: 1

  "#sound-dai-cells":
    const: 1

  clocks:
    items:
      - description: MCLK A
      - description: MCLK B
      - description: MCLK C

  clock-names:
    items:
      - const: mclk-a
      - const: mclk-b
      - const: mclk-c

required:
  - compatible
  - reg
  - resets
  - "#sound-dai-cells"

allOf:
  - $ref: dai-common.yaml#
  - if:
      properties:
        compatible:
          const: amlogic,s7d-toacodec
    then:
      properties:
        clocks: false
        clock-names: false

unevaluatedProperties: false

examples:
  - |
    #include <dt-bindings/clock/amlogic,s7d-audio-clkc.h>
    #include <dt-bindings/reset/amlogic,s7d-audio-reset.h>

    audio-controller@744 {
        compatible = "amlogic,s7d-tohdmitx";
        reg = <0x744 0x4>;
        #sound-dai-cells = <1>;
        clocks = <&clkc_audio CLKID_AUDIO_MCLK_A>,
                 <&clkc_audio CLKID_AUDIO_MCLK_B>,
                 <&clkc_audio CLKID_AUDIO_MCLK_C>;
        clock-names = "mclk-a", "mclk-b", "mclk-c";
        resets = <&clkc_audio S7D_AUDIO_RESET_TOHDMITX>;
    };
```

## Documentation/devicetree/bindings/sound/amlogic,s7d-audio-playback.yaml
```yaml
# SPDX-License-Identifier: (GPL-2.0-only OR BSD-2-Clause)
# Copyright (c) 2026 Hardkernel Co., Ltd.
%YAML 1.2
---
$id: http://devicetree.org/schemas/sound/amlogic,s7d-audio-playback.yaml#
$schema: http://devicetree.org/meta-schemas/core.yaml#

title: Amlogic S7D HDMI, analog and SPDIF playback interfaces

maintainers:
  - YoungSoo Shin <shinys000114@gmail.com>

description: |
  These children of amlogic,s7d-audio each contain a dedicated FRDDR reader,
  output engine and routing. HDMI uses FRDDR A and TDMOUT B; analog output
  uses FRDDR B and TDMOUT C; SPDIF A uses FRDDR C. Each interface provides
  one playback DAI and handles its own DMA buffer and period interrupt.
  Register access uses the parent's regmap, so neither reg nor DMAengine
  channel properties are used. Serial bit and frame clocks are generated
  internally. HDMI packets and ELD belong to the HDMI bridge DAI.

allOf:
  - $ref: dai-common.yaml#
  - if:
      properties:
        compatible:
          const: amlogic,s7d-hdmi-audio
    then:
      properties:
        clocks:
          minItems: 7
          maxItems: 7
        clock-names:
          items:
            - const: arb
            - const: fifo
            - const: tdm
            - const: mclk
            - const: bclk
            - const: lrclk
            - const: hdmi-mclk
        resets:
          minItems: 2
          maxItems: 2
        reset-names:
          items:
            - const: fifo
            - const: tdm
  - if:
      properties:
        compatible:
          const: amlogic,s7d-analog-audio
    then:
      properties:
        clocks:
          minItems: 6
          maxItems: 6
        clock-names:
          items:
            - const: arb
            - const: fifo
            - const: tdm
            - const: mclk
            - const: bclk
            - const: lrclk
        resets:
          minItems: 3
          maxItems: 3
        reset-names:
          items:
            - const: fifo
            - const: tdm
            - const: route
  - if:
      properties:
        compatible:
          const: amlogic,s7d-spdif-audio
    then:
      properties:
        clocks:
          minItems: 7
          maxItems: 7
        clock-names:
          items:
            - const: arb
            - const: fifo
            - const: tdm
            - const: mclk
            - const: mclk-sel
            - const: pll-44k
            - const: pll-48k
        resets:
          minItems: 2
          maxItems: 2
        reset-names:
          items:
            - const: fifo
            - const: spdif

properties:
  compatible:
    enum:
      - amlogic,s7d-hdmi-audio
      - amlogic,s7d-analog-audio
      - amlogic,s7d-spdif-audio

  '#sound-dai-cells':
    const: 0

  interrupts:
    maxItems: 1
    description: Period interrupt of the dedicated FRDDR channel.

  clocks:
    minItems: 6
    maxItems: 7
    description: |
      Arbiter and FRDDR gates, output-engine gate and master clock, followed
      by serial bit/frame and HDMI master clocks, or SPDIF mux and source
      PLLs. The tdm clock name denotes the SPDIF A output gate for SPDIF.

  clock-names:
    minItems: 6
    maxItems: 7

  resets:
    minItems: 2
    maxItems: 3
    description: |
      FRDDR and output-engine resets, plus the TOACODEC routing reset for
      analog output. Resets are supplied by the parent audio reset child.

  reset-names:
    minItems: 2
    maxItems: 3

required:
  - compatible
  - '#sound-dai-cells'
  - interrupts
  - clocks
  - clock-names
  - resets
  - reset-names

unevaluatedProperties: false

examples:
  - |
    #include <dt-bindings/interrupt-controller/arm-gic.h>

    hdmi-audio {
        compatible = "amlogic,s7d-hdmi-audio";
        #sound-dai-cells = <0>;
        interrupts = <GIC_SPI 36 IRQ_TYPE_EDGE_RISING>;
        clocks = <&audio_clkc 0>, <&audio_clkc 1>, <&audio_clkc 2>,
                 <&audio_clkc 3>, <&audio_clkc 4>, <&audio_clkc 5>,
                 <&audio_clkc 6>;
        clock-names = "arb", "fifo", "tdm", "mclk", "bclk", "lrclk",
                      "hdmi-mclk";
        resets = <&audio_reset 9>, <&audio_reset 13>;
        reset-names = "fifo", "tdm";
    };
```

## Documentation/devicetree/bindings/sound/amlogic,s7d-audio.yaml
```yaml
# SPDX-License-Identifier: (GPL-2.0-only OR BSD-2-Clause)
# Copyright (c) 2026 Hardkernel Co., Ltd.
%YAML 1.2
---
$id: http://devicetree.org/schemas/sound/amlogic,s7d-audio.yaml#
$schema: http://devicetree.org/meta-schemas/core.yaml#

title: Amlogic S7D audio resource controller

maintainers:
  - YoungSoo Shin <shinys000114@gmail.com>

description: |
  The controller owns the 4 KiB audio register bank, its peripheral clock,
  bus reset and power domain. Clock, reset and PCM children share its regmap
  instead of mapping overlapping registers. The separately addressed T9015
  DAC may also be a child; its address is outside the shared audio bank.

properties:
  compatible:
    const: amlogic,s7d-audio

  reg:
    maxItems: 1
    description: Audio register bank, 0x1000 bytes.

  clocks:
    maxItems: 1
    description: Audio peripheral bus clock.

  clock-names:
    const: pclk

  resets:
    maxItems: 1
    description: Top-level audio bus reset.

  reset-names:
    const: audio

  power-domains:
    maxItems: 1

  '#address-cells':
    const: 2

  '#size-cells':
    const: 2

  ranges: true

  clock-controller:
    $ref: /schemas/clock/amlogic,s7d-audio-clkc.yaml#

  reset-controller:
    $ref: /schemas/reset/amlogic,s7d-audio-reset.yaml#

  hdmi-audio:
    $ref: amlogic,s7d-audio-playback.yaml#
    properties:
      compatible:
        const: amlogic,s7d-hdmi-audio

  analog-audio:
    $ref: amlogic,s7d-audio-playback.yaml#
    properties:
      compatible:
        const: amlogic,s7d-analog-audio

  spdif-audio:
    $ref: amlogic,s7d-audio-playback.yaml#
    properties:
      compatible:
        const: amlogic,s7d-spdif-audio

patternProperties:
  '^codec@[0-9a-f]+$':
    $ref: amlogic,s7d-t9015.yaml#

required:
  - compatible
  - reg
  - clocks
  - clock-names
  - resets
  - reset-names
  - power-domains
  - '#address-cells'
  - '#size-cells'
  - ranges
  - clock-controller
  - reset-controller

additionalProperties: false

examples:
  - |
    soc {
        #address-cells = <2>;
        #size-cells = <2>;

        audio-controller@fe330000 {
            compatible = "amlogic,s7d-audio";
            reg = <0 0xfe330000 0 0x1000>;
            clocks = <&clkc 0>;
            clock-names = "pclk";
            resets = <&reset 0>;
            reset-names = "audio";
            power-domains = <&pwrdm 0>;
            #address-cells = <2>;
            #size-cells = <2>;
            ranges;

            audio_clkc: clock-controller {
                compatible = "amlogic,s7d-audio-clkc";
                #clock-cells = <1>;
                clocks = <&clkc 0>, <&clkc 1>, <&clkc 2>,
                         <&clkc 3>, <&clkc 4>, <&xtal>;
                clock-names = "pclk", "hifi1", "hifi0", "fclk-div3",
                              "fclk-div4", "xtal";
            };

            audio_reset: reset-controller {
                compatible = "amlogic,s7d-audio-reset";
                #reset-cells = <1>;
            };
        };
    };
```
