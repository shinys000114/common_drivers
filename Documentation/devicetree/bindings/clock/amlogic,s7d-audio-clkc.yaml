## Documentation/devicetree/bindings/clock/amlogic,s7d-audio-clkc.yaml
```yaml
# SPDX-License-Identifier: (GPL-2.0-only OR BSD-2-Clause)
# Copyright (c) 2026 Hardkernel Co., Ltd.
%YAML 1.2
---
$id: http://devicetree.org/schemas/clock/amlogic,s7d-audio-clkc.yaml#
$schema: http://devicetree.org/meta-schemas/core.yaml#

title: Amlogic S7D audio clock controller

maintainers:
  - YoungSoo Shin <shinys000114@gmail.com>

description: |
  Clock and reset controller of the S7D audio bus. It provides the audio
  gates, the MCLK A-F generators, the MST A-F bit and sample clocks, the
  TDMIN/TDMOUT bit and sample clock selection, the SPDIFOUT A clock and the
  MCLK pad 1 clock. It also provides the audio block resets of SW_RESET0/1.
  The node keeps the audio power domain, the bus clock and the bus reset
  released while it is bound.

  The TDM clock selectors only expose the internal MST A-F sources; the
  slave clock inputs are not wired.

  Clock IDs are defined in dt-bindings/clock/amlogic,s7d-audio-clkc.h and
  reset IDs in dt-bindings/reset/amlogic,s7d-audio-reset.h.

properties:
  compatible:
    const: amlogic,s7d-audio-clkc

  reg:
    items:
      - description: Clock and reset registers, at audio bus offset 0x000.
      - description: MCLK pad clock registers, at audio bus offset 0xe80.

  '#clock-cells':
    const: 1

  '#reset-cells':
    const: 1

  clocks:
    items:
      - description: Peripheral bus clock.
      - description: HIFI1 PLL, used for the 44.1 kHz rate family.
      - description: HIFI0 PLL, used for the 48 kHz rate family.
      - description: Fixed PLL divided by three.
      - description: Fixed PLL divided by four.
      - description: Crystal oscillator.

  clock-names:
    items:
      - const: pclk
      - const: hifi1
      - const: hifi0
      - const: fclk-div3
      - const: fclk-div4
      - const: xtal

  resets:
    maxItems: 1

  reset-names:
    items:
      - const: audio

  power-domains:
    maxItems: 1

required:
  - compatible
  - reg
  - '#clock-cells'
  - '#reset-cells'
  - clocks
  - clock-names
  - resets
  - reset-names
  - power-domains

additionalProperties: false

examples:
  - |
    bus {
        #address-cells = <2>;
        #size-cells = <2>;

        clock-controller@fe330000 {
            compatible = "amlogic,s7d-audio-clkc";
            reg = <0x0 0xfe330000 0x0 0xb8>,
                  <0x0 0xfe330e80 0x0 0x10>;
            #clock-cells = <1>;
            #reset-cells = <1>;
            clocks = <&clkc 0>, <&clkc 1>, <&clkc 2>,
                     <&clkc 3>, <&clkc 4>, <&xtal>;
            clock-names = "pclk", "hifi1", "hifi0", "fclk-div3",
                          "fclk-div4", "xtal";
            resets = <&reset 0>;
            reset-names = "audio";
            power-domains = <&pwrdm 0>;
        };
    };
```

## Documentation/devicetree/bindings/clock/amlogic,s7d-clkc.yaml
```yaml
# SPDX-License-Identifier: (GPL-2.0-only OR BSD-2-Clause)
# Copyright (c) 2026 Hardkernel Co., Ltd.
%YAML 1.2
---
$id: http://devicetree.org/schemas/clock/amlogic,s7d-clkc.yaml#
$schema: http://devicetree.org/meta-schemas/core.yaml#

title: Amlogic S7D clock and analogue controller

maintainers:
  - YoungSoo Shin <shinys000114@gmail.com>

description: |
  The controller provides the S7D clock muxes, dividers, gates and PLLs.
  Output specifiers use dt-bindings/clock/amlogic,s7d-clkc.h. Firmware
  supplies clocks through SCMI; consumers use the clock framework rather
  than programming those firmware-owned PLLs directly.

  The basic resource is the digital clock bank. The pll resource contains
  the analogue clock registers, including the HDMI PLL at offsets 0x1c0
  through 0x1cc. The optional HDMI PHY child shares this analogue window
  and must not declare an overlapping reg resource. HDMI PLL and PHY are
  not independent MMIO devices.

properties:
  compatible:
    const: amlogic,s7d-clkc

  reg:
    items:
      - description: Digital clock registers, 0x49c bytes.
      - description: Analogue PLL and HDMI PHY registers, 0x384 bytes.

  reg-names:
    items:
      - const: basic
      - const: pll

  '#clock-cells':
    const: 1

  clocks:
    items:
      - description: Crystal reference clock.
      - description: SCMI GP0 PLL source.
      - description: SCMI HIFI0 PLL source.
      - description: SCMI Ethernet HIFI1 PLL source.
      - description: SCMI system clock.
      - description: SCMI AXI clock.
      - description: SCMI fixed PLL.
      - description: SCMI GP1 PLL.
      - description: SCMI CPU clock.
      - description: SCMI DSU clock.
      - description: SCMI PWM G clock.
      - description: SCMI PWM I clock.

  clock-names:
    items:
      - const: xtal
      - const: gp0_pll_src
      - const: hifi0_pll_src
      - const: hifi1_pll_src
      - const: sys_clk
      - const: axi_clk
      - const: fixed_pll
      - const: gp1_pll
      - const: cpu_clk
      - const: dsu_clk
      - const: pwm_g
      - const: pwm_i

  hdmi-phy:
    $ref: /schemas/phy/amlogic,s7d-hdmi-phy.yaml#

required:
  - compatible
  - reg
  - reg-names
  - '#clock-cells'
  - clocks
  - clock-names

additionalProperties: false

examples:
  - |
    clkc: clock-controller@fe000000 {
        compatible = "amlogic,s7d-clkc";
        reg = <0xfe000000 0x49c>, <0xfe008000 0x384>;
        reg-names = "basic", "pll";
        #clock-cells = <1>;
        clocks = <&xtal>, <&scmi_clk 4>, <&scmi_clk 8>,
                 <&scmi_clk 10>, <&scmi_clk 12>, <&scmi_clk 13>,
                 <&scmi_clk 16>, <&scmi_clk 17>, <&scmi_clk 14>,
                 <&scmi_clk 15>, <&scmi_clk 19>, <&scmi_clk 21>;
        clock-names = "xtal", "gp0_pll_src", "hifi0_pll_src",
                      "hifi1_pll_src", "sys_clk", "axi_clk", "fixed_pll",
                      "gp1_pll", "cpu_clk", "dsu_clk", "pwm_g", "pwm_i";

        hdmi-phy {
            compatible = "amlogic,s7d-hdmi-phy";
            #phy-cells = <0>;
            clocks = <&clkc 254>;
            clock-names = "pixel";
            resets = <&reset 22>;
            reset-names = "phy";
            power-domains = <&pwrdm 3>;
        };
    };
```

## Documentation/devicetree/bindings/display/amlogic,s7d-vpu.yaml
```yaml
# SPDX-License-Identifier: (GPL-2.0-only OR BSD-2-Clause)
# Copyright (c) 2026 Hardkernel Co., Ltd.
%YAML 1.2
---
$id: http://devicetree.org/schemas/display/amlogic,s7d-vpu.yaml#
$schema: http://devicetree.org/meta-schemas/core.yaml#

title: Amlogic S7D display controller

maintainers:
  - YoungSoo Shin <shinys000114@gmail.com>

description: |
  The display controller owns the VCBUS window containing the OSD and video
  fetchers, scalers, blenders, ENCP encoder, and display RDMA engine. Its sole
  output connects to the S7D HDMI transmitter. Clock, shared reset, and power
  registers belong to their respective providers and must not be mapped here.
  Local AFBC resets are provided by a child using the same VCBUS regmap.
  An available reset child requires all four AFBC reset consumers. A disabled
  child leaves these optional, allowing board overrides to retain the entries
  without registering or accessing the local reset provider.

properties:
  compatible:
    const: amlogic,s7d-vpu

  reg:
    maxItems: 1
    description: The 256 KiB VCBUS register window.

  reg-names:
    const: vcbus

  interrupts:
    items:
      - description: VIU1 vertical synchronization, rising edge.
      - description: Display RDMA completion, rising edge.

  interrupt-names:
    items:
      - const: vsync
      - const: rdma

  clocks:
    items:
      - description: VPU processing clock.
      - description: VPU peripheral bus clock.
      - description: VPU interrupt gate.
      - description: ENCP pixel clock.
      - description: Crystal reference clock.
      - description: HDMI pixel PLL.
      - description: Video source input mux.
      - description: ENCP clock mux.
      - description: Video divider selected by the ENCP mux.
      - description: HDMI PLL shared output.
      - description: HDMI TMDS serial clock.
      - description: ENCI pixel clock for 480i and 576i.
      - description: ENCI clock mux, set to the ENCP mux's divider.
    minItems: 11

  clock-names:
    minItems: 11
    items:
      - const: vpu
      - const: vapb
      - const: intr
      - const: encp
      - const: xtal
      - const: pixel-pll
      - const: pixel-source
      - const: pixel-mux
      - const: pixel-parent
      - const: hdmi-shared
      - const: hdmi-serial
      - const: enci
      - const: enci-mux

  resets:
    minItems: 4
    maxItems: 8

  reset-names:
    minItems: 4
    items:
      - const: viu
      - const: venc
      - const: vencp
      - const: rdma
      - const: afbc-regs
      - const: afbc-logic
      - const: afbc-arbiter-regs
      - const: afbc-arbiter-logic

  power-domains:
    maxItems: 1
    description: Shared VPU and HDMI firmware power domain.

  memory-region:
    minItems: 1
    maxItems: 2
    description: |
      A dedicated reusable shared-dma-pool for scanout allocations. An optional
      second region records the firmware framebuffer reservation, which remains
      reserved and is not returned to the allocator by this driver.

  memory-region-names:
    minItems: 1
    items:
      - const: scanout
      - const: boot-logo

  reset-controller:
    $ref: /schemas/reset/amlogic,s7d-vpu-reset.yaml#

  port:
    $ref: /schemas/graph.yaml#/properties/port
    description: ENCP output to the S7D HDMI transmitter input.
    properties:
      endpoint:
        $ref: /schemas/graph.yaml#/properties/endpoint
        required:
          - remote-endpoint
    required:
      - endpoint

required:
  - compatible
  - reg
  - reg-names
  - interrupts
  - interrupt-names
  - clocks
  - clock-names
  - resets
  - reset-names
  - power-domains
  - memory-region
  - memory-region-names
  - port

allOf:
  - if:
      required:
        - reset-controller
      properties:
        reset-controller:
          properties:
            status:
              enum: [okay, ok]
    then:
      properties:
        resets:
          minItems: 8
        reset-names:
          minItems: 8
  - if:
      not:
        required:
          - reset-controller
    then:
      properties:
        resets:
          maxItems: 4
        reset-names:
          maxItems: 4
  - if:
      properties:
        memory-region-names:
          contains:
            const: boot-logo
    then:
      properties:
        memory-region:
          minItems: 2
    else:
      properties:
        memory-region:
          maxItems: 1

additionalProperties: false

examples:
  - |
    #include <dt-bindings/clock/amlogic,s7d-clkc.h>
    #include <dt-bindings/interrupt-controller/arm-gic.h>
    #include <dt-bindings/power/s7d-pd.h>
    #include <dt-bindings/reset/amlogic,meson-s7d-reset.h>
    #include <dt-bindings/reset/amlogic,s7d-vpu-reset.h>

    display-controller@ff000000 {
        compatible = "amlogic,s7d-vpu";
        reg = <0xff000000 0x40000>;
        reg-names = "vcbus";
        interrupts = <GIC_SPI 197 IRQ_TYPE_EDGE_RISING>,
                     <GIC_SPI 215 IRQ_TYPE_EDGE_RISING>;
        interrupt-names = "vsync", "rdma";
        clocks = <&clkc CLKID_VPU>, <&clkc CLKID_VAPB>,
                 <&clkc CLKID_SYS_VPU_INTR>, <&clkc CLKID_ENCP>, <&xtal>,
                 <&clkc CLKID_HDMI_PLL>, <&clkc CLKID_VIDEO_SRC0_IN_MUX>,
                 <&clkc CLKID_ENCP_MUX>, <&clkc CLKID_VIDEO0_DIV1>,
                 <&clkc CLKID_HDMI_SHARED>, <&clkc CLKID_HDMI_SERIAL>,
                 <&clkc CLKID_ENCI>, <&clkc CLKID_ENCI_MUX>;
        clock-names = "vpu", "vapb", "intr", "encp", "xtal", "pixel-pll",
                      "pixel-source", "pixel-mux", "pixel-parent",
                      "hdmi-shared", "hdmi-serial", "enci", "enci-mux";
        resets = <&reset RESET_VIU>, <&reset RESET_VENC>,
                 <&reset RESET_VENCP>, <&reset RESET_RDMA>,
                 <&vpu_reset S7D_VPU_RESET_AFBCD_REGS>,
                 <&vpu_reset S7D_VPU_RESET_AFBCD_LOGIC>,
                 <&vpu_reset S7D_VPU_RESET_AFBC_ARBITER_REGS>,
                 <&vpu_reset S7D_VPU_RESET_AFBC_ARBITER_LOGIC>;
        reset-names = "viu", "venc", "vencp", "rdma", "afbc-regs",
                      "afbc-logic", "afbc-arbiter-regs", "afbc-arbiter-logic";
        power-domains = <&pwrdm PDID_S7D_VPU_HDMI>;
        memory-region = <&display_cma>, <&boot_logo>;
        memory-region-names = "scanout", "boot-logo";

        vpu_reset: reset-controller {
            compatible = "amlogic,s7d-vpu-reset";
            #reset-cells = <1>;
        };

        port {
            vpu_out: endpoint {
                remote-endpoint = <&hdmi_in>;
            };
        };
    };
```
