## Documentation/devicetree/bindings/media/amlogic,s7d-ge2d.yaml
```yaml
# SPDX-License-Identifier: (GPL-2.0-only OR BSD-2-Clause)
%YAML 1.2
---
$id: http://devicetree.org/schemas/media/amlogic,s7d-ge2d.yaml#
$schema: http://devicetree.org/meta-schemas/core.yaml#

title: Amlogic S7D GE2D Acceleration Unit

maintainers:
  - YoungSoo Shin <shinys000114@gmail.com>

description:
  The S7D 2D graphic acceleration unit. Its registers start at word 0xa0
  of the window, it takes buffer addresses directly instead of canvas
  indexes and it has its own power domain.

properties:
  compatible:
    const: amlogic,s7d-ge2d

  reg:
    maxItems: 1

  interrupts:
    maxItems: 1

  clocks:
    items:
      - description: GE2D core clock gate, below the shared VAPB clock
      - description: GE2D bus clock

  resets:
    maxItems: 1

  power-domains:
    maxItems: 1

  memory-region:
    maxItems: 1
    description: CMA area for the frame buffers, if the default is too small.

required:
  - compatible
  - reg
  - interrupts
  - clocks
  - resets
  - power-domains

additionalProperties: false

examples:
  - |
    #include <dt-bindings/clock/amlogic,s7d-clkc.h>
    #include <dt-bindings/interrupt-controller/arm-gic.h>
    #include <dt-bindings/power/s7d-pd.h>
    #include <dt-bindings/reset/amlogic,meson-s7d-reset.h>

    ge2d@ff040000 {
        compatible = "amlogic,s7d-ge2d";
        reg = <0xff040000 0x400>;
        interrupts = <GIC_SPI 217 IRQ_TYPE_EDGE_RISING>;
        clocks = <&clkc CLKID_GE2D>, <&clkc CLKID_SYS_GE2D>;
        resets = <&reset RESET_GE2D>;
        power-domains = <&pwrdm PDID_S7D_GE2D>;
    };
```

## Documentation/devicetree/bindings/media/amlogic,s7d-vdec.yaml
```yaml
# SPDX-License-Identifier: GPL-2.0-only OR BSD-2-Clause
# Copyright (c) 2026 Hardkernel Co., Ltd.
%YAML 1.2
---
$id: http://devicetree.org/schemas/media/amlogic,s7d-vdec.yaml#
$schema: http://devicetree.org/meta-schemas/core.yaml#

title: Amlogic S7D video codec subsystem

maintainers:
  - YoungSoo Shin <shinys000114@gmail.com>

description: |
  The DOS aperture contains the VDEC, HEVC and HCODEC engines. Their mailbox
  interrupts, clocks and power domains belong to one codec device. The DMC
  request and drain registers are accessed through a separate system
  controller. The resident video firmware service and the codec device must
  reference the same enabled OP-TEE device, using the SMC conduit.

  The codec memory region must be a reusable shared-dma-pool without no-map.
  Its entire address range must fit below 4 GiB for the codec DMA engines.
  Firmware storage is managed by the firmware service, not a codec child node.

properties:
  compatible:
    const: amlogic,s7d-vdec

  reg:
    maxItems: 1
    description: DOS register aperture, 64 KiB.

  reg-names:
    const: dos

  interrupts:
    items:
      - description: VDEC mailbox interrupt
      - description: HEVC mailbox interrupt
      - description: HCODEC mailbox interrupt

  interrupt-names:
    items:
      - const: mailbox_1
      - const: mailbox_0
      - const: mailbox_2

  clocks:
    items:
      - description: DOS register bus clock
      - description: VDEC engine clock
      - description: HEVC engine clock
      - description: HCODEC engine clock

  clock-names:
    items:
      - const: dos
      - const: vdec
      - const: hevc
      - const: hcodec

  resets:
    maxItems: 1

  reset-names:
    const: hevc-pipeline

  power-domains:
    items:
      - description: VDEC power domain
      - description: HEVC power domain
      - description: HCODEC power domain

  power-domain-names:
    items:
      - const: vdec
      - const: hevc
      - const: hcodec

  amlogic,dmc-syscon:
    $ref: /schemas/types.yaml#/definitions/phandle
    description: Phandle to the S7D DMC system controller.

  amlogic,tee:
    $ref: /schemas/types.yaml#/definitions/phandle
    description: Phandle to an enabled linaro,optee-tz device using SMC.

  amlogic,video-firmware:
    $ref: /schemas/types.yaml#/definitions/phandle
    description: Phandle to the amlogic,s7d-video-firmware service.

  memory-region:
    maxItems: 1
    description: Reusable codec DMA pool entirely below 4 GiB.

  memory-region-names:
    const: codec

required:
  - compatible
  - reg
  - reg-names
  - interrupts
  - interrupt-names
  - clocks
  - clock-names
  - resets
  - reset-names
  - power-domains
  - power-domain-names
  - amlogic,dmc-syscon
  - amlogic,tee
  - amlogic,video-firmware
  - memory-region
  - memory-region-names

additionalProperties: false

examples:
  - |
    #include <dt-bindings/interrupt-controller/arm-gic.h>
    #include <dt-bindings/interrupt-controller/irq.h>

    video-codec@fe320000 {
        compatible = "amlogic,s7d-vdec";
        reg = <0xfe320000 0x10000>;
        reg-names = "dos";
        interrupts = <GIC_SPI 92 IRQ_TYPE_EDGE_RISING>,
                     <GIC_SPI 91 IRQ_TYPE_EDGE_RISING>,
                     <GIC_SPI 93 IRQ_TYPE_EDGE_RISING>;
        interrupt-names = "mailbox_1", "mailbox_0", "mailbox_2";
        clocks = <&dos_clk>, <&vdec_clk>, <&hevc_clk>, <&hcodec_clk>;
        clock-names = "dos", "vdec", "hevc", "hcodec";
        resets = <&hevc_pipeline_reset>;
        reset-names = "hevc-pipeline";
        power-domains = <&vdec_pd>, <&hevc_pd>, <&hcodec_pd>;
        power-domain-names = "vdec", "hevc", "hcodec";
        amlogic,dmc-syscon = <&dmc>;
        amlogic,tee = <&optee>;
        amlogic,video-firmware = <&video_firmware>;
        memory-region = <&codec_pool>;
        memory-region-names = "codec";
    };
```

## Documentation/devicetree/bindings/media/cec/amlogic,s7d-cecb.yaml
```yaml
# SPDX-License-Identifier: (GPL-2.0-only OR BSD-2-Clause)
# Copyright (c) 2026 Hardkernel Co., Ltd.
%YAML 1.2
---
$id: http://devicetree.org/schemas/media/cec/amlogic,s7d-cecb.yaml#
$schema: http://devicetree.org/meta-schemas/core.yaml#

title: Amlogic S7D CECB controller

maintainers:
  - YoungSoo Shin <shinys000114@gmail.com>

description: |
  The S7D always-on CECB controller handles CEC for the HDMI transmitter.
  During deep suspend and power off the AOCPU firmware runs the controller,
  answers on behalf of the system and wakes it when the TV selects this
  source. The firmware reads its configuration from two SYSCTRL status
  registers and records the wake source in a SYSCTRL sticky register.

allOf:
  - $ref: cec-common.yaml#

properties:
  compatible:
    const: amlogic,s7d-cecb

  reg:
    minItems: 1
    items:
      - description: CECB controller registers.
      - description: SYSCTRL_STATUS_REG0/1, read by the AOCPU firmware.
      - description: SYSCTRL_STICKY_REG7, the firmware wake reason.

  reg-names:
    minItems: 1
    items:
      - const: cecb
      - const: handoff
      - const: wake

  interrupts:
    maxItems: 1

  clocks:
    items:
      - description: Peripheral bus clock.
      - description: 32768 Hz CEC core clock.

  clock-names:
    items:
      - const: apb
      - const: core

  resets:
    maxItems: 1

  mboxes:
    maxItems: 1
    description:
      Mailbox channel to the AOCPU, used to pass the OSD name and vendor ID
      and to read back the message that woke the system.

  mbox-names:
    const: aocpu

required:
  - compatible
  - reg
  - interrupts
  - clocks
  - clock-names
  - resets
  - hdmi-phandle

unevaluatedProperties: false

examples:
  - |
    #include <dt-bindings/interrupt-controller/arm-gic.h>

    cec@fe044040 {
        compatible = "amlogic,s7d-cecb";
        reg = <0xfe044040 0x14>, <0xfe010280 0x8>, <0xfe0102dc 0x4>;
        reg-names = "cecb", "handoff", "wake";
        interrupts = <GIC_SPI 180 IRQ_TYPE_EDGE_RISING>;
        clocks = <&clkc 1>, <&clkc 2>;
        clock-names = "apb", "core";
        resets = <&reset 3>;
        mboxes = <&mbox 69>;
        mbox-names = "aocpu";
        hdmi-phandle = <&hdmi>;
    };
```

## Documentation/devicetree/bindings/memory-controllers/amlogic,s7d-dmc.yaml
```yaml
# SPDX-License-Identifier: GPL-2.0-only OR BSD-2-Clause
# Copyright (c) 2026 Hardkernel Co., Ltd.
%YAML 1.2
---
$id: http://devicetree.org/schemas/memory-controllers/amlogic,s7d-dmc.yaml#
$schema: http://devicetree.org/meta-schemas/core.yaml#

title: Amlogic S7D DMC request and drain system controller

maintainers:
  - YoungSoo Shin <shinys000114@gmail.com>

description: |
  The DMC request control and channel status registers gate and drain DMA
  requests from video codec engines. Consumers obtain the shared register
  map with an amlogic,dmc-syscon phandle. This system controller describes
  the 8 KiB control aperture, not the separate DDR controller register map.

properties:
  compatible:
    items:
      - const: amlogic,s7d-dmc
      - const: syscon

  reg:
    maxItems: 1
    description: DMC control register aperture, 8 KiB.

required:
  - compatible
  - reg

additionalProperties: false

examples:
  - |
    syscon@fe036000 {
        compatible = "amlogic,s7d-dmc", "syscon";
        reg = <0xfe036000 0x2000>;
    };
```

## Documentation/devicetree/bindings/phy/amlogic,s7d-hdmi-phy.yaml
```yaml
# SPDX-License-Identifier: (GPL-2.0-only OR BSD-2-Clause)
# Copyright (c) 2026 Hardkernel Co., Ltd.
%YAML 1.2
---
$id: http://devicetree.org/schemas/phy/amlogic,s7d-hdmi-phy.yaml#
$schema: http://devicetree.org/meta-schemas/core.yaml#

title: Amlogic S7D HDMI analogue PHY

maintainers:
  - YoungSoo Shin <shinys000114@gmail.com>

description: |
  The PHY is a child of the amlogic,s7d-clkc clock controller and shares
  its analogue register window. The child has no separate reg resource.
  The clock controller owns the HDMI PLL; the PHY owns HDMIPHY_CTRL0
  through HDMIPHY_CTRL5 at offsets 0x200 through 0x214 of the pll resource.
  Its pixel clock is the HDMI PLL output before the VENC dividers.
  Firmware provides the resistor calibration value through an SMC service.

properties:
  compatible:
    const: amlogic,s7d-hdmi-phy

  '#phy-cells':
    const: 0

  clocks:
    maxItems: 1

  clock-names:
    const: pixel

  resets:
    maxItems: 1

  reset-names:
    const: phy

  power-domains:
    maxItems: 1

required:
  - compatible
  - '#phy-cells'
  - clocks
  - clock-names
  - resets
  - reset-names
  - power-domains

additionalProperties: false

examples:
  - |
    hdmi-phy {
        compatible = "amlogic,s7d-hdmi-phy";
        #phy-cells = <0>;
        clocks = <&clkc 254>;
        clock-names = "pixel";
        resets = <&reset 22>;
        reset-names = "phy";
        power-domains = <&pwrdm 3>;
    };
```

## Documentation/devicetree/bindings/pinctrl/amlogic,s7d-audio-pinctrl.yaml
```yaml
# SPDX-License-Identifier: (GPL-2.0-only OR BSD-2-Clause)
# Copyright (c) 2026 Hardkernel Co., Ltd.
%YAML 1.2
---
$id: http://devicetree.org/schemas/pinctrl/amlogic,s7d-audio-pinctrl.yaml#
$schema: http://devicetree.org/meta-schemas/core.yaml#

title: Amlogic S7D audio pad crossbar

maintainers:
  - YoungSoo Shin <shinys000114@gmail.com>

description: |
  The S7D audio block has pads of its own, which the SoC pin controller
  then muxes to GPIOs. Each TDMIN lane selects the data pad it reads, each
  data pad selects the TDMOUT lane it drives or works as an input, and each
  bit and frame clock pad selects an MST A-F clock or works as an input.
  Pads TDM_D0-D8 (groups tdm_d0-tdm_d8), TDM_SCLK0-2 (tdm_sclk0-tdm_sclk2)
  and TDM_LRCLK0-2 (tdm_lrclk0-tdm_lrclk2) reach the SoC pins.

  Functions: tdmin<a-c>_lane<0-7> on a data pad makes it an input of that
  TDMIN lane, tdmout<a-c>_lane<0-7> makes it an output of that TDMOUT
  lane, tdm_clk_out<a-f> drives a clock pad from MST A-F and tdm_clk_in
  makes it an input. The MCLK pads are clocks of the audio clock
  controller.

allOf:
  - $ref: pinctrl.yaml#

properties:
  compatible:
    const: amlogic,s7d-audio-pinctrl

  reg:
    items:
      - description: Data pad registers, at audio bus offset 0xe40.
      - description: Bit and frame clock pad registers, at audio bus offset 0xe88.

  clocks:
    items:
      - description: Peripheral bus clock.

  power-domains:
    maxItems: 1

patternProperties:
  '-pins$':
    type: object
    additionalProperties: false

    patternProperties:
      '^mux(-[a-z0-9]+)?$':
        type: object
        $ref: pinmux-node.yaml#
        additionalProperties: false

        properties:
          groups:
            items:
              pattern: '^tdm_(d[0-8]|sclk[0-2]|lrclk[0-2])$'

          function:
            pattern: '^(tdmin[a-c]_lane[0-7]|tdmout[a-c]_lane[0-7]|tdm_clk_out[a-f]|tdm_clk_in)$'

        required:
          - groups
          - function

required:
  - compatible
  - reg
  - clocks
  - power-domains

additionalProperties: false

examples:
  - |
    bus {
        #address-cells = <2>;
        #size-cells = <2>;

        pinctrl@fe330e40 {
            compatible = "amlogic,s7d-audio-pinctrl";
            reg = <0x0 0xfe330e40 0x0 0x40>,
                  <0x0 0xfe330e88 0x0 0x8>;
            clocks = <&clkc 0>;
            power-domains = <&pwrdm 0>;

            i2s-pins {
                mux-out {
                    groups = "tdm_d0";
                    function = "tdmouta_lane0";
                };

                mux-in {
                    groups = "tdm_d1";
                    function = "tdmina_lane0";
                };

                mux-clk {
                    groups = "tdm_sclk0", "tdm_lrclk0";
                    function = "tdm_clk_outa";
                };
            };
        };
    };
```

## Documentation/devicetree/bindings/power/amlogic,s7d-power-domain.yaml
```yaml
# SPDX-License-Identifier: (GPL-2.0-only OR BSD-2-Clause)
# Copyright (c) 2026 Hardkernel Co., Ltd.
%YAML 1.2
---
$id: http://devicetree.org/schemas/power/amlogic,s7d-power-domain.yaml#
$schema: http://devicetree.org/meta-schemas/core.yaml#

title: Amlogic S7D firmware power domains

maintainers:
  - YoungSoo Shin <shinys000114@gmail.com>

description: |
  Firmware controls the domain transitions through SMC services. Domain
  specifiers use the IDs in dt-bindings/power/s7d-pd.h. The optional SRAM
  resource contains MEM_PD5 through MEM_PD9 and belongs to this provider.
  It permits retained VPU memory-power state to be checked independently
  of the firmware domain state. Native VPU/HDMI consumers require this
  window. MEM_PD10 and MEM_PD11 are excluded from the resource.

properties:
  compatible:
    const: amlogic,s7d-power-domain

  reg:
    maxItems: 1
    description: VPU SRAM power registers MEM_PD5 through MEM_PD9, 0x14 bytes.

  reg-names:
    const: vpu-sram

  '#power-domain-cells':
    const: 1

required:
  - compatible
  - '#power-domain-cells'

dependencies:
  reg: [reg-names]
  reg-names: [reg]

additionalProperties: false

examples:
  - |
    power-controller@fe00c054 {
        compatible = "amlogic,s7d-power-domain";
        reg = <0xfe00c054 0x14>;
        reg-names = "vpu-sram";
        #power-domain-cells = <1>;
    };
```

## Documentation/devicetree/bindings/reset/amlogic,s7d-audio-reset.yaml
```yaml
# SPDX-License-Identifier: (GPL-2.0-only OR BSD-2-Clause)
# Copyright (c) 2026 Hardkernel Co., Ltd.
%YAML 1.2
---
$id: http://devicetree.org/schemas/reset/amlogic,s7d-audio-reset.yaml#
$schema: http://devicetree.org/meta-schemas/core.yaml#

title: Amlogic S7D audio reset controller

maintainers:
  - YoungSoo Shin <shinys000114@gmail.com>

description: |
  Child of the amlogic,s7d-audio resource controller. Active-high internal
  resets use SW_RESET0 and SW_RESET1 in the parent's regmap. The top-level
  audio bus reset belongs to the parent, not to this controller.
  Reset IDs are defined in dt-bindings/reset/amlogic,s7d-audio-reset.h.
  IDs 0 through 32 and 40 are valid; the other second-bank bits are reserved.

properties:
  compatible:
    const: amlogic,s7d-audio-reset

  '#reset-cells':
    const: 1

required:
  - compatible
  - '#reset-cells'

additionalProperties: false

examples:
  - |
    reset-controller {
        compatible = "amlogic,s7d-audio-reset";
        #reset-cells = <1>;
    };
```
