## drivers/drm/Kconfig
```kconfig
# SPDX-License-Identifier: (GPL-2.0+ OR MIT)

config AMLOGIC_DRM
	tristate "DRM Support for Amlogic new Display Controller"
	default n
	depends on AMLOGIC_DRIVER && DRM && OF && (ARM || ARM64)
	select DRM_KMS_HELPER
	select DRM_GEM_DMA_HELPER
	select VIDEOMODE_HELPERS
	select DRM_DISPLAY_HELPER
	select DRM_DISPLAY_HDCP_HELPER
	select DRM_DISPLAY_DP_AUX_BUS
	select DRM_DISPLAY_DP_HELPER
	help
		amlogic new soc display controller
		use the pipeline and modularized

config AMLOGIC_DRM_VPU
	bool "support drm vpu function for meson drm display."
	default n
	depends on AMLOGIC_DRM
	help
		add drm vpu support.
		Choose this option if you have a aMLOGIC soc chipset.
		This driver provides KMS.
		This driver also provides crtcs and planes management.

config AMLOGIC_DRM_CUT_HDMI
	bool "support drm hdmi function for meson drm display."
	depends on !(AMLOGIC_HDMITX || AMLOGIC_HDMITX21)
	help
		add drm hdmi support.
		use internal amlogic media vout hdmi driver.
		We should confirm AMLOGIC_HDMITX is configured if
		AMLOGIC_DRM_HDMI is selected.

config AMLOGIC_DRM_CUT_HDMI_MODERN
	bool "support drm hdmi function for meson drm display."
	depends on !(AMLOGIC_HDMITX_MODERN || AMLOGIC_HDMITX21_MODERN)
	help
		add drm hdmi support.
		use internal amlogic media vout hdmi driver.
		We should confirm AMLOGIC_HDMITX_MODERN is configured if
		AMLOGIC_DRM_HDMI is selected.

config AMLOGIC_DRM_DP
	bool "support drm dp function for meson drm display."
	depends on AMLOGIC_DPTX
	help
		add drm dp support.
		use internal amlogic media vout dp driver.
		We should confirm AMLOGIC_DPTX is configured if
		AMLOGIC_DRM_DP is selected.

config AMLOGIC_DRM_EDP
	bool "support drm edp function for meson drm display."
	depends on AMLOGIC_DPTX
	help
		add drm edp support.
		use internal amlogic media vout dptx driver.
		We should confirm AMLOGIC_DPTX is configured if
		AMLOGIC_DRM_EDP is selected.

config AMLOGIC_DRM_CUT_CVBS
	bool "support drm cvbs function for meson drm display."
	depends on !AMLOGIC_CVBS_OUTPUT
	help
		add drm cvbs support.
		use internal amlogic media vout cvbs driver.
		We should confirm AMLOGIC_CVBSOUT is configured if
		AMLOGIC_DRM_CVBS is selected.

config AMLOGIC_DRM_PANEL
	bool "support drm panel function for meson drm display."
	default n
	depends on AMLOGIC_DRM
	depends on AMLOGIC_LCD
	depends on DRM_PANEL
	help
		add drm panel support.
		use internal amlogic media vout lcd driver.
		We should confirm AMLOGIC_LCD is configured if
		AMLOGIC_DRM_PANEL is selected.

config AMLOGIC_DRM_eDP
	bool "support drm eDP function for meson drm display."
	default n
	depends on AMLOGIC_DRM
	depends on AMLOGIC_eDPTX
	help
		add drm eDP Panel support.
		use internal amlogic media vout DisplayPort driver.
		We should confirm AMLOGIC_eDPTX is configured if
		AMLOGIC_DRM_PANEL is selected.

config AMLOGIC_DRM_USE_ION
	bool "gem use ion to alloc/free graphic buffer."
	default n
	depends on AMLOGIC_DRM
	help
		MESON DRM use CMA HELPER to manage framebuffer.
		It need reserve memory in CMA pool.
		We implement GEM to allocate/free framebuffer from ion.
		For dumb used by displaycontrol we alloc from the ION CMA HEAP.
		For dumb used by app, we can alloc from the ION.
		SYSTEM HEAP which dont need reserve memory.

config AMLOGIC_DRM_EMULATE_FBDEV
	bool "emulate framebuffer dev by drm."
	default n
	depends on AMLOGIC_DRM && AMLOGIC_DRM_USE_ION
	select DRM_FBDEV_EMULATION
	select FB_DMAMEM_HELPERS
	help
		Emulate framebuffer device for device
		which need use fbdev api.

source "$(COMMON_DRIVERS_DIR)/drivers/drm/odroidc5/Kconfig"
```

## drivers/drm/odroidc5/Kconfig
```kconfig
# SPDX-License-Identifier: GPL-2.0-only
# Copyright (c) 2026 Hardkernel Co., Ltd.

config AMLOGIC_C5_NATIVE_DISPLAY
	bool "C5 native VPU/HDMI integration (experimental)"
	depends on AMLOGIC_C5_DISPLAY_RESOURCES
	depends on DRM = y && I2C = y && AMLOGIC_CPU_INFO = y
	depends on DMA_CMA && REGMAP_MMIO
	depends on !AMLOGIC_MEDIA_ENABLE
	select PHY_MESON_S7D_HDMI
	select RESET_S7D_VPU
	select DRM_KMS_HELPER
	select DRM_GEM_DMA_HELPER
	select DRM_DISPLAY_HELPER
	select DRM_DISPLAY_HDMI_HELPER
	select DRM_BRIDGE_CONNECTOR
	select SND_SOC_HDMI_CODEC if SND_SOC
	help
	  Build the S7D VPU execution path and native RGB8 TMDS bridge, with
	  DRM EDID/SCDC helpers, CCF consumers and generic PHY ownership.
	  Static device trees and built-in drivers only; unbind is suppressed.
	  Register one CRTC, linear RGB primary, linear NV12/NV21 VD1/VD2 video and
	  shared OSD2 cursor/overlay planes, and an HDMI connector.
	  Cursor and RGB overlay cannot be visible together. Video is progressive
	  8-bit SDR with BT.601/709 limited/full-range conversion.
	  Each local OSD scaler supports up to 4x enlargement and 2:1 reduction,
	  including simultaneous primary and RGB overlay scaling. Linear RGB
	  scaling requires opaque pixels and input width up to 1920.
	  VD1 supports up to 4x enlargement and 8x downscaling
	  in 1080p output modes. Linear video and OSD scaling may run together
	  within a checked combined clock budget. VD2 is unscaled up to 2048x1080;
	  VD1 and VD2 together exclude OSD2. VD2 does not combine with AFBC.
	  AFBC ABGR8888 supports a primary or OSD2 overlay up to 4096x2160,
	  with opaque global alpha and optional premultiplied pixel alpha.
	  AFBC scaling uses the same local OSD limits and uncropped source.
	  An AFBC primary can use a linear OSD2 cursor or
	  overlay. Only one AFBC surface is active. An opaque unscaled AFBC
	  primary can combine with unscaled video up to 1080p at 148.5 MHz;
	  joint primary/video changes require a stopped modeset.
	  Requires retained firmware output on S7D revision B, with SDR RGB8 TMDS up to 594 MHz.
	  Do not enable with legacy media/display writers. System sleep supports
	  s2idle after native takeover, retaining the shared display domain.
	  HDMI PCM uses SND_SOC_HDMI_CODEC with SND_SOC_MESON_S7D_HDMI_AUDIO
	  and SND_SOC_ODROIDC5. Deep sleep, hibernation and cold HDMI SRAM
	  initialization are not supported.
```

## drivers/drm/s7d/Kconfig
```kconfig
# SPDX-License-Identifier: GPL-2.0-only
# Copyright (c) 2026 Hardkernel Co., Ltd.

config DRM_S7D
	tristate "Amlogic S7D display controller and HDMI transmitter (experimental)"
	depends on AMLOGIC_C5_DISPLAY_RESOURCES
	depends on DRM && I2C && AMLOGIC_CPU_INFO
	depends on DMA_CMA && REGMAP_MMIO
	depends on !AMLOGIC_MEDIA_ENABLE
	select PHY_MESON_S7D_HDMI
	select RESET_S7D_VPU
	select DRM_KMS_HELPER
	select DRM_GEM_DMA_HELPER
	select DRM_DISPLAY_HELPER
	select DRM_DISPLAY_HDMI_HELPER
	select DRM_BRIDGE_CONNECTOR
	select SND_SOC_HDMI_CODEC if SND_SOC
	help
	  Build the S7D VPU execution path and HDMI transmitter bridge, with
	  DRM EDID/SCDC helpers, CCF consumers and generic PHY ownership.
	  Built in or as the module s7d-drm. Unbinding stops the output and
	  frees its resources; buffers the hardware may still read after a
	  failed stop are leaked.
	  Register one CRTC, a linear RGB primary, VD1/VD2 video planes and
	  shared OSD2 cursor/overlay planes, an HDMI connector and a VDIN1
	  writeback connector. NV12/NV21 primary framebuffers scan out on VD1.
	  Cursor and RGB overlay cannot be visible together; the cursor takes
	  ARGB8888 up to 256x256. Video is progressive NV12/NV21/NV16/NV61,
	  UYVY/VYUY, VUY888 or XVYU2101010 with BT.601/709/2020
	  limited/full-range conversion; VD1 also reads 8- and 10-bit 4:2:0
	  Amlogic FBC decoder frames.
	  Each local OSD scaler supports up to 4x enlargement and 2:1 reduction,
	  including simultaneous primary and RGB overlay scaling. Linear RGB
	  scaling requires opaque pixels and input width up to 3840.
	  VD1 supports up to 4x enlargement and 8x downscaling up to UHD
	  output, skipping source lines where a reduction would outrun the
	  fetch. Linear video and OSD scaling may run together within a checked
	  combined clock budget. VD2 uses independent classic PPS for sources
	  up to 2048x1080.
	  The primary takes compressed framebuffers only with
	  s7d_drm.primary_afbc=1, as switching it between compressed and
	  linear or YUV framebuffers takes a modeset. Mali AFBCD reads ABGR8888
	  in the tiled 32x8 layout and ARGB8888/XRGB8888 in the untiled one,
	  on a primary or OSD2 overlay up to 4096x2160, with opaque global
	  alpha and optional premultiplied pixel alpha.
	  AFBC scaling uses the same local OSD limits and uncropped source.
	  An AFBC primary can use a linear OSD2 cursor or
	  overlay. Mali AFBCD can decode the primary and the OSD2 overlay together
	  (no cursor), up to 3840x2160 decoded pixels in total; adding or
	  removing one of them requires a stopped modeset. An AFBC primary can
	  combine with VD1 and VD2 up to 1080p at 148.5 MHz while only VD1
	  scales, and only to enlarge; joint primary/video changes require a
	  stopped modeset. FBC video does not combine with compressed graphics.
	  Interlaced 1080i, 480i and 576i output takes linear OSD planes only.
	  Supports S7D revision B, with TMDS up to 594 MHz. Takes over a firmware
	  output when there is one; otherwise starts the display from reset.
	  Do not enable with legacy media/display writers. System sleep, including
	  deep sleep where firmware powers the display domain off, restores the
	  output. Before the first commit, sleep is refused while a firmware
	  output still runs.
	  HDMI PCM uses SND_SOC_HDMI_CODEC with the Amlogic AXG sound card
	  (SND_MESON_AXG_SOUND_CARD). Cold HDMI SRAM initialization is not
	  supported.

config DRM_S7D_GFCD
	bool "S7D GFCD compressed primary plane (experimental)"
	depends on DRM_S7D
	help
	  Use GFCD for AFBC primaries that Mali AFBCD cannot read
	  (XBGR8888), and for ABGR8888 with the GFCD primary policy. Supports
	  ABGR8888 and XBGR8888 in the 32x8 tiled AFBC layout, with framebuffers
	  up to 4096x2160, width aligned to 32 and height aligned to 8.
	  Integer source windows up to 1920x1080 at 148.5 MHz are supported.
	  XBGR8888 always ignores X and uses opaque pixels. The local
	  OSD1 scaler supports up to 4x enlargement or 2x reduction into a
	  1920x1080 output with opaque pixels, subject to the core clock budget.
	  Unscaled ABGR8888 also supports premultiplied alpha.
	  GFCD also reads RGBA8888 AFRC primaries (SCAN layout, coding unit
	  16, 24 or 32 bytes) with dimensions aligned to 64x16, within the
	  same window, scaler and alpha limits and without reflection.
	  Linear or Mali AFBCD OSD2 overlays remain available; video and
	  simultaneous GFCD surfaces are excluded. GFCD primaries need
	  s7d_drm.primary_afbc=1.
	  Requires the retained GFCD automatic clock and reset configuration.
	  Keep disabled to use only the Mali AFBCD backend.

choice
	prompt "S7D AFBC primary decoder policy"
	depends on DRM_S7D
	default DRM_S7D_AFBC_POLICY_MALI
	help
	  Select which decoder reads an ABGR8888 AFBC primary, offered with
	  s7d_drm.primary_afbc=1. The s7d_drm.afbc_policy parameter (0 Mali,
	  1 GFCD) overrides it.

config DRM_S7D_AFBC_POLICY_MALI
	bool "Mali AFBCD"
	help
	  Decode every ABGR8888 AFBC plane with Mali AFBCD, S0 for the
	  primary and S1 for the OSD2 overlay. GFCD only reads XBGR8888 AFBC
	  and AFRC.

config DRM_S7D_AFBC_POLICY_GFCD_PRIMARY
	bool "GFCD within its envelope"
	depends on DRM_S7D_GFCD
	help
	  Decode an AFBC primary up to 1920x1080 at 148.5 MHz with GFCD,
	  leaving Mali AFBCD S1 for the OSD2 overlay.

endchoice
```

## drivers/firmware/amlogic/Kconfig
```kconfig
# SPDX-License-Identifier: GPL-2.0-only
# Copyright (c) 2026 Hardkernel Co., Ltd.

config AMLOGIC_S7D_VIDEO_FIRMWARE
	tristate "Amlogic S7D resident video firmware archive"
	depends on ARM64 && OF
	depends on AMLOGIC_AMLTEE && AMLOGIC_OPTEE && !AMLOGIC_MEDIA_ENABLE
	select FW_LOADER
	help
	  Own the immutable video firmware archive uploaded through OP-TEE.
	  Decoder and encoder consumers may reload without uploading it again.
	  A module build remains resident until reboot because the secure archive
	  has no verified unload or state-query API. Forced unload and dynamic
	  removal of this firmware service are not supported.
```

## drivers/gpu/arm/midgard/platform/c5/Kconfig
```kconfig
# SPDX-License-Identifier: GPL-2.0-only
# Copyright (c) 2026 Hardkernel Co., Ltd.

choice
	prompt "ODROID-C5 GPU driver"
	depends on ARCH_MESON_ODROID_COMMON && ARM64 && OF
	default AMLOGIC_C5_GPU_PANTHOR
	help
	  Only one of the two Mali-G310 drivers can be built, as both bind the
	  same GPU node and need different userspace.

config AMLOGIC_C5_GPU_PANTHOR
	bool "Panthor (Mesa)"
	help
	  Allow the S7D Panthor fork (DRM_S7D_PANTHOR) for Mesa's Panfrost
	  and PanVK drivers; the vendor kbase driver is not built.

config AMLOGIC_C5_GPU_KBASE
	bool "ODROID-C5 vendor Mali platform"
	depends on PM && COMMON_CLK
	depends on DRM_PANTHOR = n
	select RESET_CONTROLLER
	help
	  Use the C5 clock, reset and runtime PM consumers with vendor kbase.
	  Preserves the CSF userspace ABI for the matching libMali and firmware.

endchoice
```

## drivers/gpu/drm/panthor/Kconfig
```kconfig
# SPDX-License-Identifier: GPL-2.0 or MIT

config DRM_S7D_PANTHOR
	tristate "Panthor for the S7D Mali-G310 (Linux 6.18 backport)"
	depends on DRM
	depends on ARM || ARM64 || COMPILE_TEST
	depends on !DRM_PANTHOR
	depends on !GENERIC_ATOMIC64
	depends on MMU
	depends on DMA_CMA
	select DEVFREQ_GOV_SIMPLE_ONDEMAND
	select DRM_EXEC
	select DRM_GEM_SHMEM_HELPER
	select DRM_GPUVM
	select DRM_SCHED
	select IOMMU_IO_PGTABLE_LPAE
	select IOMMU_SUPPORT
	select PM_DEVFREQ
	help
	  DRM driver for ARM Mali CSF-based GPUs, forked from Linux 6.18 for
	  the S7D Mali-G310. It can be built beside the vendor kbase driver:
	  the panthor device tree overlay gives the GPU node the compatible
	  Panthor binds to, and without the overlay kbase keeps the GPU.

	  This driver is for Mali (or Immortalis) Valhall Gxxx GPUs.

	  Note that the Mali-G68 and Mali-G78, while Valhall architecture, will
	  be supported with the panfrost driver as they are not CSF GPUs.
```

## drivers/media/cec/platform/meson/Kconfig
```kconfig
# SPDX-License-Identifier: GPL-2.0-only
# Copyright (c) 2026 Hardkernel Co., Ltd.

config CEC_MESON_S7D
	bool "Amlogic S7D standard CEC controller"
	depends on DRM_S7D && OF && COMMON_CLK
	depends on RESET_CONTROLLER && AMLOGIC_MEDIA_ENABLE = n
	select CEC_CORE
	select CEC_NOTIFIER
	help
	  Provide the standard CEC adapter for the S7D CECB controller and
	  S7D HDMI transmitter. The controller uses independent CCF clocks,
	  reset and pinctrl resources. For deep suspend and power off the
	  controller is handed to the AOCPU firmware, which wakes the system
	  when the TV selects this source.

config CEC_MESON_S7D_AOCPU
	bool "Pass CEC identity and wake messages to the S7D AOCPU"
	depends on CEC_MESON_S7D && AMLOGIC_MHU_MBOX
	help
	  Send the OSD name and vendor ID to the AOCPU firmware before sleep,
	  and deliver the CEC message that woke the system after resume. This
	  uses the vendor AOCPU mailbox driver and its message layout.
	  Without it, wake still works, but the firmware answers with its
	  default name and the wake message is lost.
```
