## drivers/media/platform/amlogic/meson-ge2d/Kconfig
```kconfig
# SPDX-License-Identifier: GPL-2.0-only
# Copyright (c) 2026 Hardkernel Co., Ltd.

config VIDEO_S7D_GE2D
	tristate "Amlogic S7D 2D graphic acceleration unit"
	depends on ARCH_MESON_ODROID_COMMON && OF && COMMON_CLK && PM
	depends on V4L_MEM2MEM_DRIVERS && VIDEO_DEV
	depends on VIDEO_MESON_GE2D=n && AMLOGIC_MEDIA_ENABLE=n
	select VIDEOBUF2_DMA_CONTIG
	select V4L2_MEM2MEM_DEV
	help
	  V4L2 mem2mem driver for the S7D GE2D. It converts between the RGB
	  formats of the upstream driver and NV12, NV21, NV16, NV61 and
	  YUV24, also reads YUV420, YVU420, YUV422P and UYVY, scales up to
	  16x from the crop to the compose rectangle, flips and rotates, and
	  converts colour with the BT.601, BT.709 or BT.2020 matrix. A second,
	  multi-planar node offers the same and also reads two-buffer NV12M
	  and NV21M. Forked from the upstream Meson GE2D driver, which depends
	  on ARCH_MESON, with the S7D register block, direct address registers
	  and runtime power management.
```

## drivers/media/platform/amlogic/s7d/Kconfig
```kconfig
# SPDX-License-Identifier: GPL-2.0-only
# Copyright (c) 2026 Hardkernel Co., Ltd.

config VIDEO_AMLOGIC_S7D
	tristate "Amlogic S7D stateful video decoder"
	depends on ARM64 && OF && VIDEO_DEV
	depends on COMMON_CLK && PM && PM_GENERIC_DOMAINS && RESET_CONTROLLER
	depends on DMA_CMA && OF_RESERVED_MEM
	depends on AMLOGIC_TEE && AMLOGIC_OPTEE && !AMLOGIC_MEDIA_ENABLE
	depends on AMLOGIC_S7D_VIDEO_FIRMWARE
	select MFD_SYSCON
	select V4L2_MEM2MEM_DEV
	select VIDEOBUF2_VMALLOC
	help
	  Standard stateful V4L2 memory-to-memory decoder node for the S7D
	  DOS codec engines. It always decodes H.264 (progressive High
	  profile up to 4096x2304 at 30 frames per second) on the VDEC
	  engine; the options below add codecs on the HEVC engine and the
	  JPEG encoder on HCODEC. The codec firmware is loaded through the
	  Amlogic TEE service. VDEC and HCODEC run one session each, the
	  HEVC engine up to four HEVC, VP9 and AV1 sessions picture by
	  picture, and different engines run at the same time: an H.264
	  decode, decodes on the HEVC engine and a JPEG encode can share the
	  DOS.

config VIDEO_AMLOGIC_S7D_HEVC_EXPERIMENTAL
	bool "Amlogic S7D HEVC decoder"
	depends on VIDEO_AMLOGIC_S7D
	default y
	select VIDEO_AMLOGIC_S7D_HEVC_ENGINE
	help
	  Add HEVC to the S7D video decoder node, decoded on the HEVC engine.
	  It takes progressive Main and Main10 4:2:0 streams up to 4096x2304
	  at 60 frames per second, including resolution changes, and returns
	  8-bit NV12 or NV12M frames or Amlogic FBC frames of the stream's
	  depth, with several slices, tiles, dependent slices, long-term
	  references and temporal sub-layers.

config VIDEO_AMLOGIC_S7D_VP9_EXPERIMENTAL
	bool "Amlogic S7D VP9 decoder"
	depends on VIDEO_AMLOGIC_S7D
	default y
	select VIDEO_AMLOGIC_S7D_HEVC_ENGINE
	help
	  Add VP9 to the S7D video decoder node, decoded on the HEVC engine.
	  It takes profile 0 and profile 2 (8-bit and 10-bit 4:2:0) streams
	  up to 4096x2304 at 60 frames per second, including superframes with
	  hidden, intra-only and show-existing frames, and returns 8-bit NV12
	  or NV12M frames or Amlogic FBC frames of the stream's depth. The
	  frame size, depth and colour may change at a key frame (dynamic
	  resolution change), not between inter frames: reference scaling is
	  not supported.

config VIDEO_AMLOGIC_S7D_HEVC_ENGINE
	bool

config VIDEO_AMLOGIC_S7D_AV1_EXPERIMENTAL
	bool "Amlogic S7D AV1 decoder"
	depends on VIDEO_AMLOGIC_S7D
	default y
	select VIDEO_AMLOGIC_S7D_HEVC_ENGINE
	help
	  Add AV1 to the S7D video decoder node, decoded on the HEVC engine.
	  It takes Main profile 8-bit and 10-bit 4:2:0 OBU streams up to
	  4096x2304 at 60 frames per second, with up to 16 frames in a
	  temporal unit, and returns 8-bit NV12 or NV12M frames or Amlogic
	  FBC frames of the stream's depth. A new sequence header or a key
	  frame of another size, also one below the sequence maximum, changes
	  the resolution dynamically; an inter frame of another size is not
	  supported. Streams with film grain decode, but without the grain:
	  the decoder outputs the picture before grain synthesis, which the
	  vendor applies only at scanout. Super-resolution is not supported.

config VIDEO_AMLOGIC_S7D_JPEG_EXPERIMENTAL
	bool "Amlogic S7D JPEG encoder"
	depends on VIDEO_AMLOGIC_S7D
	default y
	help
	  Register an additional standard V4L2 memory-to-memory JPEG encoder
	  on the HCODEC engine. It takes contiguous NV12 or NV21 frames from
	  16x16 up to 1920x1080 through MMAP or DMABUF buffers and produces
	  baseline 8-bit 4:2:0 JPEG with the standard compression quality
	  control. It runs while the video decoders are decoding.
```

## drivers/mfd/Kconfig
```kconfig
# SPDX-License-Identifier: (GPL-2.0+ OR MIT)
#
# Multifunction miscellaneous devices
#

menuconfig AMLOGIC_MFD
	tristate "Amlogic mfd devices"
	default n
	help
	  Say Y here, and a list of multifunction drivers will be displayed.
	  Everything that didn't fit into the other categories is here. This option
	  doesn't affect the kernel.

	  If unsure, say Y.

if AMLOGIC_MFD

config AMLOGIC_MFD_PMIC6B
	bool "Amlogic MFD PMIC6B"
	depends on I2C
	depends on MFD_CORE
	depends on REGMAP_I2C
	depends on REGMAP_IRQ
	default n
	help
	  Say yes here to add support for the Amlogic MFD PMIC.
	  This driver provides common support for accessing the device,
	  additional drivers must be enabled in order to use the
	  functionality of the device.

endif

config MFD_MESON_S7D_AUDIO
	tristate "Amlogic S7D audio resource controller"
	depends on ARM64 && OF && COMMON_CLK && RESET_CONTROLLER && PM
	depends on AMLOGIC_SND_SOC = n
	select REGMAP_MMIO
	help
	  Own the audio register bank and provide a shared regmap to its
	  clock, reset and ASoC children. The bus clock and power domain stay
	  referenced while the children are registered. Requires a device tree
	  with the overlapping vendor audio devices disabled.
```

## drivers/phy/amlogic/Kconfig
```kconfig
# SPDX-License-Identifier: GPL-2.0-only
# Copyright (c) 2026 Hardkernel Co., Ltd.

config PHY_MESON_S7D_HDMI
	bool "Amlogic S7D HDMI analog PHY"
	depends on AMLOGIC_C5_DISPLAY_RESOURCES
	select GENERIC_PHY
	help
	  Control the HDMI analog lanes through the S7D clock provider regmap,
	  with CCF, reset and runtime PM consumers and firmware trim calibration.
```

## drivers/reset/Kconfig
```kconfig
# SPDX-License-Identifier: (GPL-2.0+ OR MIT)

if RESET_CONTROLLER

config AMLOGIC_RESET_MESON
	tristate "Meson Reset Driver"
	help
	  This enables the reset driver for Amlogic Meson SoCs.

config AMLOGIC_DOS_RESET_MESON
	tristate "Meson Dos Reset Driver"
	help
	  This enables the reset driver for Amlogic Dos Meson SoCs.

config RESET_S7D_VPU
	tristate "Amlogic S7D VPU local resets"
	depends on REGMAP
	help
	  Provide local AFBC and arbiter reset levels through the VPU parent's
	  regmap. Acquiring these reset lines does not change their state.

config RESET_S7D_AUDIO_ARB
	tristate "Amlogic S7D audio memory arbiter reset"
	depends on ARCH_MESON_ODROID_COMMON && OF && COMMON_CLK
	depends on RESET_MESON_AUDIO_ARB=n
	help
	  Reset and enable the audio DDR arbiter ports of the S7D audio
	  block. Forked from the upstream Meson audio arbiter driver.

endif
```

## sound/soc/Kconfig
```kconfig
# SPDX-License-Identifier: (GPL-2.0+ OR MIT)

if SND_SOC
source "$(COMMON_DRIVERS_DIR)/sound/soc/codecs/Kconfig"
source "$(COMMON_DRIVERS_DIR)/sound/soc/amlogic/Kconfig"
source "$(COMMON_DRIVERS_DIR)/sound/soc/amlogic/auge/vad/Kconfig"
source "$(COMMON_DRIVERS_DIR)/sound/soc/meson/Kconfig"
endif   # SND_SOC
```

## sound/soc/meson/Kconfig
```kconfig
# SPDX-License-Identifier: GPL-2.0-only
# Copyright (c) 2026 Hardkernel Co., Ltd.

config SND_SOC_MESON_S7D
	tristate "Amlogic S7D audio"
	depends on ARCH_MESON_ODROID_COMMON && OF && COMMON_CLK
	depends on SND_MESON_AXG_FIFO=n && SND_MESON_AXG_TDM_FORMATTER=n
	depends on SND_MESON_CARD_UTILS=n && SND_MESON_CODEC_GLUE=n
	depends on SND_SOC_MESON_T9015=n
	select REGMAP_MMIO
	select SND_DYNAMIC_MINORS
	select SND_PCM_IEC958
	imply RESET_S7D_AUDIO_ARB
	help
	  FRDDR/TODDR FIFOs, TDM interfaces and formatters, SPDIF output,
	  HDMI and internal DAC glue, the T9015 DAC and the sound card for
	  the S7D audio block. Forked from the upstream Meson AXG/G12A ASoC
	  drivers, which cannot be built on this platform.
```
