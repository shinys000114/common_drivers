## Documentation/devicetree/bindings/sound/amlogic,s7d-tdm-formatters.yaml
```yaml
# SPDX-License-Identifier: (GPL-2.0-only OR BSD-2-Clause)
%YAML 1.2
---
$id: http://devicetree.org/schemas/sound/amlogic,s7d-tdm-formatters.yaml#
$schema: http://devicetree.org/meta-schemas/core.yaml#

title: Amlogic S7D TDM formatters

maintainers:
  - YoungSoo Shin <shinys000114@gmail.com>

description:
  TDM input and output formatters of the S7D audio block. TDMIN writes
  its slot count to CTRL0; TDMOUT has no CTRL1 gain switch.

properties:
  compatible:
    enum:
      - amlogic,s7d-tdmin
      - amlogic,s7d-tdmout

  clocks:
    items:
      - description: Peripheral clock
      - description: Bit clock
      - description: Bit clock input multiplexer
      - description: Sample clock
      - description: Sample clock input multiplexer

  clock-names:
    items:
      - const: pclk
      - const: sclk
      - const: sclk_sel
      - const: lrclk
      - const: lrclk_sel

  reg:
    maxItems: 1

  resets:
    maxItems: 1

required:
  - compatible
  - reg
  - clocks
  - clock-names
  - resets

allOf:
  - $ref: component-common.yaml#

unevaluatedProperties: false

examples:
  - |
    #include <dt-bindings/clock/amlogic,s7d-audio-clkc.h>
    #include <dt-bindings/reset/amlogic,s7d-audio-reset.h>

    audio-controller@540 {
        compatible = "amlogic,s7d-tdmout";
        reg = <0x540 0x40>;
        resets = <&clkc_audio S7D_AUDIO_RESET_TDMOUTB>;
        clocks = <&clkc_audio CLKID_AUDIO_GATE_TDMOUTB>,
                 <&clkc_audio S7D_AUDIO_CLK_TDMOUT_B_SCLK>,
                 <&clkc_audio S7D_AUDIO_CLK_TDMOUT_B_SCLK_SEL>,
                 <&clkc_audio S7D_AUDIO_CLK_TDMOUT_B_LRCLK>,
                 <&clkc_audio S7D_AUDIO_CLK_TDMOUT_B_LRCLK>;
        clock-names = "pclk", "sclk", "sclk_sel", "lrclk", "lrclk_sel";
    };
```

## Documentation/devicetree/bindings/sound/hardkernel,odroidc5-audio.yaml
```yaml
# SPDX-License-Identifier: (GPL-2.0-only OR BSD-2-Clause)
# Copyright (c) 2026 Hardkernel Co., Ltd.
%YAML 1.2
---
$id: http://devicetree.org/schemas/sound/hardkernel,odroidc5-audio.yaml#
$schema: http://devicetree.org/meta-schemas/core.yaml#

title: Hardkernel ODROID-C5 playback sound card

maintainers:
  - YoungSoo Shin <shinys000114@gmail.com>

description: |
  The card connects S7D playback interfaces to the native HDMI bridge,
  internal T9015 DAC and an optional SPDIF transmitter codec. HDMI and
  analog links use I2S with normal polarity and the CPU supplying bit and
  frame clocks. The analog link routes the two DAC line outputs to the
  board's line-output connector. The HDMI codec's graph endpoint connects
  to the VPU display controller for power-management ordering.
  Analog and SPDIF links may be disabled and enabled by board overlays.

$defs:
  dai:
    type: object
    properties:
      sound-dai:
        maxItems: 1
        description: Phandle to the single playback DAI.
    required:
      - sound-dai
    additionalProperties: false

  link:
    type: object
    properties:
      status: true
      cpu:
        $ref: '#/$defs/dai'
      codec:
        $ref: '#/$defs/dai'
    required:
      - cpu
      - codec
    additionalProperties: false

properties:
  compatible:
    const: hardkernel,odroidc5-audio

  hdmi:
    $ref: '#/$defs/link'
    description: TDMOUT B playback to the native HDMI bridge DAI.

  analog:
    $ref: '#/$defs/link'
    description: TDMOUT C playback to the internal T9015 DAC DAI.

  spdif:
    $ref: '#/$defs/link'
    description: SPDIF A playback to a linux,spdif-dit codec DAI.

required:
  - compatible
  - hdmi

additionalProperties: false

examples:
  - |
    sound {
        compatible = "hardkernel,odroidc5-audio";

        hdmi {
            cpu {
                sound-dai = <&hdmi_audio>;
            };
            codec {
                sound-dai = <&hdmi>;
            };
        };

        analog {
            status = "disabled";
            cpu {
                sound-dai = <&analog_audio>;
            };
            codec {
                sound-dai = <&t9015>;
            };
        };

        spdif {
            status = "disabled";
            cpu {
                sound-dai = <&spdif_audio>;
            };
            codec {
                sound-dai = <&spdif_dit>;
            };
        };
    };
```
