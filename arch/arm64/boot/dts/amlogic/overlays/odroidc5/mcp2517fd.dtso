/dts-v1/;
/plugin/;

#include <dt-bindings/gpio/meson-s7d-gpio.h>
#include <dt-bindings/gpio/gpio.h>
#include <dt-bindings/interrupt-controller/irq.h>
#include <dt-bindings/interrupt-controller/amlogic,meson-s7d-gpio-intc.h>

&{/} {
	can0_clk: can0_clk {
		compatible = "fixed-clock";
		#clock-cells = <0>;
		clock-frequency = <20000000>;
	};
};

&spicc0 {
	status = "okay";
	#address-cells = <1>;
	#size-cells = <0>;
	pinctrl-names = "default";
	cs-gpios = <&gpio GPIOX_10 GPIO_ACTIVE_LOW>;
	pinctrl-0 = <&spicc0_pins_x_sw>;

	mcp2517fd: can@0 {
		compatible = "microchip,mcp2517fd";
		reg = <0>;
		clocks = <&can0_clk>;
		interrupt-parent = <&gpio_intc>;
		interrupts = <IRQID_GPIOX_5 IRQ_TYPE_LEVEL_LOW>;
		spi-max-frequency = <10000000>;
		spi-cs-setup-delay-ns = <1000>;
		spi-cs-hold-delay-ns = <1000>;
		spi-cs-inactive-delay-ns = <1000>;
		status = "okay";
	};
};
