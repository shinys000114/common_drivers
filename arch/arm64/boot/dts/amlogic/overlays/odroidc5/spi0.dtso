/dts-v1/;
/plugin/;

#include <dt-bindings/gpio/meson-s7d-gpio.h>
#include <dt-bindings/gpio/gpio.h>

&spicc0 {
	status = "okay";
	#address-cells = <1>;
	#size-cells = <0>;
	num-cs = <1>;
	cs-gpios = <&gpio GPIOX_10 GPIO_ACTIVE_LOW>;

	spidev0: spidev@0 {
		status = "okay";
		compatible = "linux,spidev";
		reg = <0>;
		spi-max-frequency = <100000000>; // 100MHz
		rx-sample-delay-ns = <4>;
		amlogic,tx-delay-ns = <0>;
	};
};
